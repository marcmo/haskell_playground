AUTOSAR XML (schema 2.1.4)
package /interfaces
  31 x sender receiver interface:
    IPwCcm
      data ccmId0x0103PwEksNormingRequired: type=Boolean
      data ccmId0x0105PwEksErrorOrInitRequired: type=Boolean
    IPwIntegrationFemComATemp
      data comTempEx: type=UInt8
    IPwComBedienungShdMds
      data comOpSwShdmds: type=UInt8
    IPwComCrash
      data comCtrCrClsy: type=UInt2
    IPwComCtrCabrf
      data comRqRlsCabrf: type=UInt2
      data comRqCtrWrgCabrf: type=UInt4
    IPwComCtrFhBft
      data comCtrWrgPsdPsd: type=UInt3
    IPwIntegrationFemComCtrFhBfth
      4 x data, all with type=UInt3:
        comCtrWrgDrdPsdr
        comCtrWrgPsdPsdr
        comCtrWrgDvdrPsdr
        comCtrWrgPsdrPsdr
    IPwComCtrFhFat
      5 x data:
        comOpChislDrd: type=UInt2
        comCtrWrgPsdDrd: type=UInt3
        comCtrWrgPsdrDrd: type=UInt3
        comCtrWrgDvdrDrd: type=UInt3
        comCtrWrgDrdDrd: type=UInt3
    IPwIntegrationFemComCtrFhFath
      4 x data, all with type=UInt3:
        comCtrWrgDrdDvdr
        comCtrWrgPsdDvdr
        comCtrWrgDvdrDvdr
        comCtrWrgPsdrDvdr
    IPwComCtrFhShdZentrale
      13 x data:
        comStWrgEnb: type=UInt2
        comStStsrEnb: type=UInt2
        comStPanMod: type=UInt2
        comStChisl: type=UInt2
        comStCffu: type=UInt4
        comCtrWrgPsdCntr: type=UInt3
        comCtrWrgPsdrCntr: type=UInt3
        comCtrWrgDvdrCntr: type=UInt3
        comCtrWrgDrdCntr: type=UInt3
        comCtrStsrCntr: type=UInt3
        comCtrSrblCntr: type=UInt3
        comCtrChisl: type=UInt2
        comAuthWrgStsr: type=UInt32
    IPwComCtrPblSbDrdLin
      data comCtrLedFnbut1Lin: type=UInt2
      data comCtrLedFnbut2Lin: type=UInt2
    IPwComStEngRunDrv
      data comStEngRunDrv: type=UInt2
      data comStDrvVeh: type=UInt8
    IPwIntegrationFemComKilometerstand
      data comMileKm: type=UInt24
    IPwComKlemmen
      data comStKl: type=UInt4
      data comStKlKeyVld: type=UInt4
    IPwComKlemmenstatus
      4 x data, all with type=UInt2:
        comStKlR
        comStKl15
        comStKeyVld
        comStKeyPlgd
    IPwComPositionFhBft
      4 x data:
        comPoWrgPsd: type=UInt8
        comStPoWrgPsd: type=UInt2
        comStErrWrgPsd: type=UInt3
        comStDrvWrgPsd: type=UInt2
    IPwIntegrationFemComPositionFhBfth
      5 x data:
        comPoWrgPsdr: type=UInt8
        comStPoWrgPsdr: type=UInt2
        comStChislPsdr: type=UInt2
        comStErrWrgPsdr: type=UInt3
        comStDrvWrgPsdr: type=UInt2
    IPwComPositionFhFat
      4 x data:
        comPoWrgDrd: type=UInt8
        comStPoWrgDrd: type=UInt2
        comStErrWrgDrd: type=UInt3
        comStDrvWrgDrd: type=UInt2
    IPwIntegrationFemComPositionFhFath
      5 x data:
        comPoWrgDvdr: type=UInt8
        comStPoWrgDvdr: type=UInt2
        comStChislDvdr: type=UInt2
        comStErrWrgDvdr: type=UInt3
        comStDrvWrgDvdr: type=UInt2
    IPwComPositionShd
      12 x data:
        comPoShd: type=UInt8
        comPoShdTlt: type=UInt8
        comPoSos: type=UInt8
        comPoSosTlt: type=UInt8
        comStDrvShd: type=UInt3
        comStDrvSos: type=UInt3
        comStErrShd: type=UInt3
        comStErrSos: type=UInt3
        comStPoShd: type=UInt2
        comStPoShdTlt: type=UInt2
        comStPoSos: type=UInt2
        comStPoSosTlt: type=UInt2
    IPwIntegrationFemComRelativzeit
      data comTSecCouRel: type=UInt32
    IPwComSbAbfrageFhDrdLin
      12 x data:
        comStChoswExmiDdpdLin: type=UInt2
        comStPubuExmiFmirLin: type=UInt2
        comStPubuExmiDdpdHoadLin: type=UInt2
        comStPubuExmiDdpdVeadLin: type=UInt2
        comStFnbut1DrdLin: type=UInt3
        comStFnbut2DrdLin: type=UInt3
        comCtrWrgFlhDrdLin: type=UInt3
        comCtrWrgRlhDrdLin: type=UInt3
        comCtrWrgFrhDrdLin: type=UInt3
        comCtrWrgRrhDrdLin: type=UInt3
        comNodErrSwclDrLin: type=UInt2
        comCtrWrgAllLin: type=UInt3
    IPwComStCabrf
      4 x data:
        comStSrcOpCabrf: type=UInt8
        comStPoCabrfRetrf: type=UInt4
        comStPoCabrf: type=UInt4
        comStOpCabrf: type=UInt4
    IPwComStatFunkschluessel
      4 x data:
        comOpKeyButUlok: type=UInt2
        comOpKeyButLok: type=UInt2
        comNoKeyPrslImme: type=UInt4
        comStLokRqFfbLfsr: type=UInt2
    IPwComStatZvKlappen
      5 x data:
        comStDswDrd: type=UInt2
        comStDswDvdr: type=UInt2
        comStDswPsd: type=UInt2
        comStDswPsdr: type=UInt2
        comStClsy: type=UInt4
    IPwComVVeh
      4 x data:
        comVVehCog: type=UInt16
        comDvcoVeh: type=UInt3
        comCrcVVeh: type=UInt8
        comAlivVVeh: type=UInt4
    IPwDriverStateIntegrComp
      16 x data:
        isReversing: type=Boolean
        thermo90: type=Boolean
        hallStatus: type=UInt8
        openRelayStatus: type=UInt8
        closeRelayStatus: type=UInt8
        windowState: type=UInt8
        windowMovement: type=UInt8
        init_nr: type=UInt8
        bewegung_nr: type=UInt8
        position_nr: type=UInt8
        position_hall_wert: type=SInt16
        position_hall_max_wert: type=SInt16
        position_mm_wert: type=SInt16
        position_mm_max_wert: type=SInt16
        position_prozent_wert: type=UInt8
        lage_nr: type=UInt8
    IPwIntegrationIGR
      data IGR: type=Boolean
    IPwIntegrationKeyRange
      data cahLfPingDebounced: type=Boolean
    IPwSwitchPsd
      data ctrWrgPsdPsd: type=UInt3
    IPwSwitchesDrd
      4 x data, all with type=UInt3:
        ctrWrgDrdDrd
        ctrWrgDvdrDrd
        ctrWrgPsdDrd
        ctrWrgPsdrDrd
  7 x client server interface:
    IPwRxTxNotification
      operation msgRxVVeh
    IPwComEKSDebug
      operation com0x79cDebugEKS
        arg eksInfo: type=ByteArray8, direction=IN
    IPwComDebugData
      operation sendDebugData
        arg debugData: type=ByteArray8, direction=IN
    ISwcPwIntegrationFemDiag
      18 x operation:
        diagJobReadFhFaTaster
          5 x arg:
            requestData: type=ByteArray1, direction=IN
            requestLength: type=UInt16, direction=IN
            responseData: type=ByteArray9, direction=OUT
            responseLength: type=UInt16, direction=OUT
            result: type=UInt8, direction=OUT
        diagJobReadFhBfTaster
          5 x arg:
            requestData: type=ByteArray1, direction=IN
            requestLength: type=UInt16, direction=IN
            responseData: type=ByteArray1, direction=OUT
            responseLength: type=UInt16, direction=OUT
            result: type=UInt8, direction=OUT
        diagJobReadFhKisiTaster
          5 x arg:
            requestData: type=ByteArray1, direction=IN
            requestLength: type=UInt16, direction=IN
            responseData: type=ByteArray2, direction=OUT
            responseLength: type=UInt16, direction=OUT
            result: type=UInt8, direction=OUT
        diagJobReadFhKisiLed
          5 x arg:
            requestData: type=ByteArray1, direction=IN
            requestLength: type=UInt16, direction=IN
            responseData: type=ByteArray2, direction=OUT
            responseLength: type=UInt16, direction=OUT
            result: type=UInt8, direction=OUT
        diagJobReadFhFaBewegung
          5 x arg:
            requestData: type=ByteArray1, direction=IN
            requestLength: type=UInt16, direction=IN
            responseData: type=ByteArray19, direction=OUT
            responseLength: type=UInt16, direction=OUT
            result: type=UInt8, direction=OUT
        diagJobReadFhBfBewegung
          5 x arg:
            requestData: type=ByteArray1, direction=IN
            requestLength: type=UInt16, direction=IN
            responseData: type=ByteArray19, direction=OUT
            responseLength: type=UInt16, direction=OUT
            result: type=UInt8, direction=OUT
        diagJobReadFhKlemmenspannung30a
          5 x arg:
            requestData: type=ByteArray1, direction=IN
            requestLength: type=UInt16, direction=IN
            responseData: type=ByteArray1, direction=OUT
            responseLength: type=UInt16, direction=OUT
            result: type=UInt8, direction=OUT
        diagJobReadFhKlemmenspannung30b
          5 x arg:
            requestData: type=ByteArray1, direction=IN
            requestLength: type=UInt16, direction=IN
            responseData: type=ByteArray1, direction=OUT
            responseLength: type=UInt16, direction=OUT
            result: type=UInt8, direction=OUT
        diagJobReadFhBfRelais
          5 x arg:
            requestData: type=ByteArray1, direction=IN
            requestLength: type=UInt16, direction=IN
            responseData: type=ByteArray8, direction=OUT
            responseLength: type=UInt16, direction=OUT
            result: type=UInt8, direction=OUT
        diagJobReadFhFaHallsensoren
          5 x arg:
            requestData: type=ByteArray1, direction=IN
            requestLength: type=UInt16, direction=IN
            responseData: type=ByteArray6, direction=OUT
            responseLength: type=UInt16, direction=OUT
            result: type=UInt8, direction=OUT
        diagJobReadFhFaRelais
          5 x arg:
            requestData: type=ByteArray1, direction=IN
            requestLength: type=UInt16, direction=IN
            responseData: type=ByteArray8, direction=OUT
            responseLength: type=UInt16, direction=OUT
            result: type=UInt8, direction=OUT
        diagJobReadFhBfHallsensoren
          5 x arg:
            requestData: type=ByteArray1, direction=IN
            requestLength: type=UInt16, direction=IN
            responseData: type=ByteArray6, direction=OUT
            responseLength: type=UInt16, direction=OUT
            result: type=UInt8, direction=OUT
        diagJobStartRoutineFhTasterSteuern
          5 x arg:
            requestData: type=ByteArray4, direction=IN
            requestLength: type=UInt16, direction=IN
            responseData: type=ByteArray1, direction=OUT
            responseLength: type=UInt16, direction=OUT
            result: type=UInt8, direction=OUT
        diagJobStopRoutineFhTasterSteuern
          5 x arg:
            requestData: type=ByteArray1, direction=IN
            requestLength: type=UInt16, direction=IN
            responseData: type=ByteArray1, direction=OUT
            responseLength: type=UInt16, direction=OUT
            result: type=UInt8, direction=OUT
        diagJobRequestResultFhTasterSteuern
          5 x arg:
            requestData: type=ByteArray1, direction=IN
            requestLength: type=UInt16, direction=IN
            responseData: type=ByteArray1, direction=OUT
            responseLength: type=UInt16, direction=OUT
            result: type=UInt8, direction=OUT
        diagJobIOControlReturnControlEcuFhHallVersorgung
          5 x arg:
            requestData: type=ByteArray1, direction=IN
            requestLength: type=UInt16, direction=IN
            responseData: type=ByteArray1, direction=OUT
            responseLength: type=UInt16, direction=OUT
            result: type=UInt8, direction=OUT
        diagJobIOControlShortTimeAdjustFhHallVersorgung
          5 x arg:
            requestData: type=ByteArray2, direction=IN
            requestLength: type=UInt16, direction=IN
            responseData: type=ByteArray2, direction=OUT
            responseLength: type=UInt16, direction=OUT
            result: type=UInt8, direction=OUT
        diagJobWriteFhKisiTaster
          5 x arg:
            requestData: type=ByteArray2, direction=IN
            requestLength: type=UInt16, direction=IN
            responseData: type=ByteArray1, direction=OUT
            responseLength: type=UInt16, direction=OUT
            result: type=UInt8, direction=OUT
    IPwIntegrationFemIoAdapterInCallback
      4 x operation:
        icHallADrd
        icHallBDrd
        icHallAPsd
        icHallBPsd
    IPwIntegrationFemIoAdapterIn
      21 x operation:
        diSigAnWlDrdincrHall1
          arg diValue: type=Boolean, direction=OUT
        diSigAnWlDrdincrHall2
          arg diValue: type=Boolean, direction=OUT
        diSigAnWlPsdincrHall1
          arg diValue: type=Boolean, direction=OUT
        diSigAnWlPsdincrHall2
          arg diValue: type=Boolean, direction=OUT
        aiSigAnWlDrdincHall1
          arg aiValue: type=UInt16, direction=OUT
        aiSigAnWlDrdincHall2
          arg aiValue: type=UInt16, direction=OUT
        aiSigAnWlPsdincHall1
          arg aiValue: type=UInt16, direction=OUT
        aiSigAnWlPsdincHall2
          arg aiValue: type=UInt16, direction=OUT
        aiSigAnPowWindPsd
          arg aiValue: type=UInt16, direction=OUT
        aiSigDiRelaystateDrd
          arg aiValue: type=UInt8, direction=OUT
        aiSigDiRelaystatePsd
          arg aiValue: type=UInt8, direction=OUT
        aiSigDiRelayFeedBackDrdUp
          arg diValue: type=Boolean, direction=OUT
        aiSigDiRelayFeedBackDrdDown
          arg diValue: type=Boolean, direction=OUT
        aiSigDiRelayFeedBackPsdUp
          arg diValue: type=Boolean, direction=OUT
        aiSigDiRelayFeedBackPsdDown
          arg diValue: type=Boolean, direction=OUT
        aiTerm30L1
          arg aiValue: type=UInt16, direction=OUT
        aiTerm30L2
          arg aiValue: type=UInt16, direction=OUT
        aiSigPeriodTimeDrdHall1
          arg aiValue: type=UInt32, direction=OUT
        aiSigPeriodTimeDrdHall2
          arg aiValue: type=UInt32, direction=OUT
        aiSigPeriodTimePsdHall1
          arg aiValue: type=UInt32, direction=OUT
        aiSigPeriodTimePsdHall2
          arg aiValue: type=UInt32, direction=OUT
    IPwIntegrationFemIoAdapterOut
      5 x operation:
        doWlEsaHallOn
          arg doValue: type=Boolean, direction=IN
        doPwrWindowLifterDrdUp
          arg doValue: type=Boolean, direction=IN
        doPwrWindowLifterDrdDown
          arg doValue: type=Boolean, direction=IN
        doPwrWindowLifterPsdUp
          arg doValue: type=Boolean, direction=IN
        doPwrWindowLifterPsdDown
          arg doValue: type=Boolean, direction=IN
  calprm interface IPwApplIntegrationCalprm
    calprm element prototype cpFensterheberElektrisch: compu {1=FENSTERHEBER_ELEKTRISCH_default, 1=FENSTERHEBER_ELEKTRISCH_aktiv, 0=FENSTERHEBER_ELEKTRISCH_nicht_aktiv}, type=Boolean  # @sem: prefix: FENSTERHEBER_ELEKTRISCH enum { 1=default 1=aktiv 0=nicht_aktiv }
    calprm element prototype cpFhCcMeldung: compu {4=FH_CC_MELDUNG_default, 1=FH_CC_MELDUNG_ccm_denorm, 2=FH_CC_MELDUNG_ccm_panic, 3=FH_CC_MELDUNG_ccm_panic_denorm, 0=FH_CC_MELDUNG_keine_ccm}, type=UInt2  # @sem: prefix: FH_CC_MELDUNG enum { 4=default 1=ccm_denorm 2=ccm_panic 3=ccm_panic_denorm 0=keine_ccm }
  sender receiver interface IPwKlemmen
    data comStKl: type=UInt4
    data comStKlKeyVld: type=UInt4
  sender receiver interface IPwStatZvKlappen
    5 x data:
      comStDswDrd: type=UInt2
      comStDswDvdr: type=UInt2
      comStDswPsd: type=UInt2
      comStDswPsdr: type=UInt2
      comStClsy: type=UInt4
