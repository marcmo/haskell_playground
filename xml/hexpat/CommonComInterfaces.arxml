AUTOSAR XML (schema 2.1.4)
package /interfaces
  sender receiver interface IComCtrCasSfyc
    14 x data:
      comCtrWrgAlSfyc1: sw-calibration-access=READ-ONLY, compu {3=CTR_WRG_AL_SFYC_1_Signal_ungueltig, 1=CTR_WRG_AL_SFYC_1_Alle_Fenster_im_Panikmodus_schli, 0=CTR_WRG_AL_SFYC_1_kein_Alarmschliessen}, sw-variable-access-impl-policy=OPTIMIZED, type=UInt2
      comCtrKlSfyc1:
        sw-calibration-access=READ-ONLY
        compu {15=CTR_KL_SFYC_1_Signal_ungueltig, 14=CTR_KL_SFYC_1_Fehler, 13=CTR_KL_SFYC_1_KL50_Ein, 12=CTR_KL_SFYC_1_KL50_Aenderung, 11=CTR_KL_SFYC_1_KL50_Verzoegerung, 10=CTR_KL_SFYC_1_KL15_Ein, 9=CTR_KL_SFYC_1_KL15_Aenderung, 8=CTR_KL_SFYC_1_KLR_Ein, 7=CTR_KL_SFYC_1_KLR_Aenderung, 6=CTR_KL_SFYC_1_KL30B_Ein, 5=CTR_KL_SFYC_1_KL30B_Aenderung, 4=CTR_KL_SFYC_1_KL30F_Ein, 3=CTR_KL_SFYC_1_KL30F_Aenderung, 2=CTR_KL_SFYC_1_KL30, 1=CTR_KL_SFYC_1_Reserve, 0=CTR_KL_SFYC_1_Init}
        sw-variable-access-impl-policy=OPTIMIZED
        type=UInt4
      comCtrKlDivSfyc1:
        sw-calibration-access=READ-ONLY
        compu {15=CTR_KL_DIV_SFYC_1_KL_DIV_INVALID, 14=CTR_KL_DIV_SFYC_1_KL_DIV_FAILURE, 13=CTR_KL_DIV_SFYC_1_KL_DIV_TIMEOUT, 12=CTR_KL_DIV_SFYC_1_KL_DIV_INVALID_CP, 11=CTR_KL_DIV_SFYC_1_KL_DIV_TIMEOUT_CP, 10=CTR_KL_DIV_SFYC_1_KL_DIV_FAILURE_CP, 9=CTR_KL_DIV_SFYC_1_KL_DIV_BLOCKED, 8=CTR_KL_DIV_SFYC_1_KL_DIV_VALID_IDLE, 7=CTR_KL_DIV_SFYC_1_KL_DIV_RELEASE_TRIG, 6=CTR_KL_DIV_SFYC_1_KL_DIV_WAIT_VALID, 5=CTR_KL_DIV_SFYC_1_KL_DIV_WAIT_NVM, 4=CTR_KL_DIV_SFYC_1_KL_DIV_SAVED, 3=CTR_KL_DIV_SFYC_1_KL_DIV_RELEASED, 2=CTR_KL_DIV_SFYC_1_KL_DIV_REQUEST, 1=CTR_KL_DIV_SFYC_1_KL_DIV_IDLE, 0=CTR_KL_DIV_SFYC_1_KL_DIV_INIT}
        sw-variable-access-impl-policy=OPTIMIZED
        type=UInt4
      comCtrEngSfyc1: sw-calibration-access=READ-ONLY, compu {3=CTR_ENG_SFYC_1_Signal_ungueltig, 2=CTR_ENG_SFYC_1_Motor_aus, 1=CTR_ENG_SFYC_1_Default, 0=CTR_ENG_SFYC_1_Init}, sw-variable-access-impl-policy=OPTIMIZED, type=UInt2
      comCtrClsySfyc1: sw-calibration-access=READ-ONLY, compu {15=CTR_CLSY_SFYC_1_Signal_ungueltig, 8=CTR_CLSY_SFYC_1_Keine_Aenderung}, sw-variable-access-impl-policy=OPTIMIZED, type=UInt4
      comCtrClsyRlsSfyc1: sw-calibration-access=READ-ONLY, compu {15=CTR_CLSY_RLS_SFYC_1_Signal_ungueltig}, sw-variable-access-impl-policy=OPTIMIZED, type=UInt4
      comCtrClsyPsdSfyc1: sw-calibration-access=READ-ONLY, compu {15=CTR_CLSY_PSD_SFYC_1_Signal_ungueltig, 8=CTR_CLSY_PSD_SFYC_1_Keine_Aenderung}, sw-variable-access-impl-policy=OPTIMIZED, type=UInt4
      comCtrClsyPsdrSfyc1: sw-calibration-access=READ-ONLY, compu {15=CTR_CLSY_PSDR_SFYC_1_Signal_ungueltig, 8=CTR_CLSY_PSDR_SFYC_1_Keine_Aenderung}, sw-variable-access-impl-policy=OPTIMIZED, type=UInt4
      comCtrClsyFuffSfyc1: sw-calibration-access=READ-ONLY, compu {15=CTR_CLSY_FUFF_SFYC_1_Signal_ungueltig, 8=CTR_CLSY_FUFF_SFYC_1_Keine_Aenderung}, sw-variable-access-impl-policy=OPTIMIZED, type=UInt4
      comCtrClsyDvdrSfyc1: sw-calibration-access=READ-ONLY, compu {15=CTR_CLSY_DVDR_SFYC_1_Signal_ungueltig, 8=CTR_CLSY_DVDR_SFYC_1_Keine_Aenderung}, sw-variable-access-impl-policy=OPTIMIZED, type=UInt4
      comCtrClsyDrdSfyc1: sw-calibration-access=READ-ONLY, compu {15=CTR_CLSY_DRD_SFYC_1_Signal_ungueltig, 8=CTR_CLSY_DRD_SFYC_1_Keine_Aenderung}, sw-variable-access-impl-policy=OPTIMIZED, type=UInt4
      comCtrClsyBtlSfyc1: sw-calibration-access=READ-ONLY, compu {15=CTR_CLSY_BTL_SFYC_1_Signal_ungueltig, 8=CTR_CLSY_BTL_SFYC_1_Keine_Aenderung}, sw-variable-access-impl-policy=OPTIMIZED, type=UInt4
      comCrcSfyc1: type=UInt8
      comAlivCouSfyc1: sw-calibration-access=READ-ONLY, compu {15=ALIV_COU_SFYC_1_Signal_ungueltig}, sw-variable-access-impl-policy=OPTIMIZED, type=UInt4
  compu method comIdFnCos_Semantic: 5=ID_FN_COS_Signal_ungueltig, 1=ID_FN_COS_Selective_Catalytic_Reduction, 0=ID_FN_COS_Cabrioverdeck, 9=ID_FN_COS_Vorhanglauf, 8=ID_FN_COS_Schiebe_Hebedach, 6=ID_FN_COS_Fensterheber_hinten, 5=ID_FN_COS_Fensterheber_vorne, 3=ID_FN_COS_Sitzverstellung_Beifahrer, 2=ID_FN_COS_Sitzverstellung_Fahrer, 0=ID_FN_COS_Steuergeraet_EHB3_DSC, 6=ID_FN_COS_Heckklimageblaease, 5=ID_FN_COS_Fondklimageblaese, 2=ID_FN_COS_PTC, 1=ID_FN_COS_Klimakompressor_Regelventil, 0=ID_FN_COS_Klimageblaese, 7=ID_FN_COS_Musikleistung, 5=ID_FN_COS_Scheibenwischer, 4=ID_FN_COS_Leseleuchten, 3=ID_FN_COS_Anhaengerleuchten, 2=ID_FN_COS_Aussenlicht, 1=ID_FN_COS_Innenlicht, 0=ID_FN_COS_Reserviert
  compu method comStFnCos_Semantic: 3=ST_FN_COS_Signal_ungueltig, 1=ST_FN_COS_Verbraucherfunktion_iGR_relevant, 0=ST_FN_COS_Verbraucherfunktion_nicht_iGR_re
  compu method comRqRemSerFn_Semantic: 5=RQ_REM_SER_FN_Signal_ungueltig, 1=RQ_REM_SER_FN_Welcome_Light, 0=RQ_REM_SER_FN_Hupe
  compu method comTranfCcMessStd_Semantic: 5=TRANF_CC_MESS_STD_Signal_ungueltig
  compu method comStIdcCclkCcMessStd_Semantic: 3=ST_IDC_CCLK_CC_MESS_STD_Signal_ungueltig, 2=ST_IDC_CCLK_CC_MESS_STD_Schnelles_Blinken, 1=ST_IDC_CCLK_CC_MESS_STD_Langsames_Blinken, 0=ST_IDC_CCLK_CC_MESS_STD_Kein_Blinken
  compu method comStCcMessStd_Semantic: 3=ST_CC_MESS_STD_Signal_ungueltig, 1=ST_CC_MESS_STD_Setzen, 0=ST_CC_MESS_STD_Ruecksetzen
  compu method comWaca_Semantic: 5=WACA_Signal_ungueltig, 3=WACA_Ungueltiger_Weckgrund, 2=WACA_Kupplungsschalter, 1=WACA_Bremslichtschalter, 8=WACA_Taster_Beifahrertuer_entriegeln_k, 7=WACA_Taster_Fahrertuer_entriegeln_kapa, 0=WACA_Taster_Beifahrertuer_hinten_entri, 9=WACA_Taster_Fahrertuer_hinten_entriege, 4=WACA_Klemme_15_Wakeupleitung, 3=WACA_Kuehlmittelabfrage_durch_Kombi, 2=WACA_Ablauf_Timer_Standheizung_lueften, 1=WACA_Intelligenter_Batterie_Sensor_v, 0=WACA_Hotelschalter, 9=WACA_Wakeup_Signal_von_TCU, 8=WACA_Fernbedienungsdienste_RKE, 7=WACA_Niveauregulierung_Luftfeder, 6=WACA_Lenksaeulenverstellschalter, 5=WACA_Entertainment_Button, 4=WACA_EMF_Taster, 3=WACA_Getriebewahlschalter, 2=WACA_Schalter_Innenbeleuchtung_Dachm, 1=WACA_Lenkstocktaster_in_Richtung__Lic, 0=WACA_Lenkstocktaster_in_Richtung__Bli, 8=WACA_Schalter_Warnblinken, 7=WACA_Lichtschalter_ein_redundant, 6=WACA_Parkstellung_Automatik, 5=WACA_Center_Lock_Unlock, 4=WACA_Hallsensor_Eject, 3=WACA_Start_Stop_Taster_B, 2=WACA_Start_Stop_Taster_A, 0=WACA_Kurzschluss_Klemme_30_B, 9=WACA_Tuerschloss_verriegeln_Komfortschl, 8=WACA_Tuerschloss_entriegeln_Komfortoeffn, 7=WACA_Motorhaubenkontakt, 6=WACA_Eingang_Heckscheibenkontakt, 5=WACA_Heckklappenkontakt, 4=WACA_Taster_Oeffner_Heckscheibe, 3=WACA_Taster_Oeffner_Heckklappe, 2=WACA_Taster_Heckklappe_oeffnen_innen, 1=WACA_Taster_Beifahrertuer_CA, 0=WACA_Taster_Fahrertuer_CA, 9=WACA_Tuerkontakt_hinten_rechts, 8=WACA_Tuerkontakt_hinten_links, 7=WACA_Tuerkontakt_vorne_rechts, 6=WACA_Tuerkontakt_vorne_links, 8=WACA_Emergency_Call, 7=WACA_Remote_Services, 6=WACA_Aussenspiegel, 5=WACA_Abschaltung_Klemme_VA, 4=WACA_Eject_Button, 3=WACA_CO2_Erkennung, 2=WACA_Restwaerme, 1=WACA_Diebstahlwarnanlage, 0=WACA_Steuergeraete_Reset
  compu method comEcuIdWupreg_Semantic: 5=ECU_ID_WUPREG_Signal_ungueltig
  compu method comPiaFnIdDtInqyAck_Semantic: 5=PIA_FN_ID_DT_INQY_ACK_Signal_ungueltig
  compu method comPiaProfilNoDtInqyAck_Semantic: 5=PIA_PROFIL_NO_DT_INQY_ACK_Werkstattprofil_bzw_ungueltiges, 4=PIA_PROFIL_NO_DT_INQY_ACK_Defaultprofil, 0=PIA_PROFIL_NO_DT_INQY_ACK_Gastprofil, 2=PIA_PROFIL_NO_DT_INQY_ACK_Benutzerprofil_2, 1=PIA_PROFIL_NO_DT_INQY_ACK_Benutzerprofil_1, 0=PIA_PROFIL_NO_DT_INQY_ACK_Benutzerprofil_0
  compu method comPiaFnIdDtSetAck_Semantic: 5=PIA_FN_ID_DT_SET_ACK_Signal_ungueltig
  compu method comPiaProfilNoDtSetAck_Semantic: 5=PIA_PROFIL_NO_DT_SET_ACK_Werkstattprofil_bzw_ungueltiges, 4=PIA_PROFIL_NO_DT_SET_ACK_Defaultprofil, 0=PIA_PROFIL_NO_DT_SET_ACK_Gastprofil, 2=PIA_PROFIL_NO_DT_SET_ACK_Benutzerprofil_2, 1=PIA_PROFIL_NO_DT_SET_ACK_Benutzerprofil_1, 0=PIA_PROFIL_NO_DT_SET_ACK_Benutzerprofil_0
  compu method comPiaFnIdSuAnsw_Semantic: 5=PIA_FN_ID_SU_ANSW_Signal_ungueltig
  compu method comIdFnRqBus_Semantic: 5=ID_FN_RQ_BUS_Signal_ungueltig, 8=ID_FN_RQ_BUS_Niveauregulierung, 9=ID_FN_RQ_BUS_Regeneration_Supercaps, 8=ID_FN_RQ_BUS_Standlueften, 5=ID_FN_RQ_BUS_Nachlauf_E_Luefter, 6=ID_FN_RQ_BUS_Nachlauf_elektrische_Zusatzwasse, 3=ID_FN_RQ_BUS_Nachlauf_elektrische_Wasserpumpe, 2=ID_FN_RQ_BUS_Tankleckdiagnose, 8=ID_FN_RQ_BUS_Weckerproblem, 7=ID_FN_RQ_BUS_Einschlafverhinderer, 5=ID_FN_RQ_BUS_Notruf, 4=ID_FN_RQ_BUS_Kombi_Anzeige, 3=ID_FN_RQ_BUS_Kuehlmitteltemperaturabfrage_durc, 1=ID_FN_RQ_BUS_KL15Wup_Signal, 6=ID_FN_RQ_BUS_Anforderung_Aussenbeleuchtung, 5=ID_FN_RQ_BUS_Rollueberwachung, 4=ID_FN_RQ_BUS_EMF_Taster, 3=ID_FN_RQ_BUS_Diebstahlwarnanlage, 8=ID_FN_RQ_BUS_Remote_Hupen, 7=ID_FN_RQ_BUS_Nachlauf_Zuschaltung_RSE, 6=ID_FN_RQ_BUS_Betaetigung_Feststellbremse, 5=ID_FN_RQ_BUS_Verlaengerung_N_Haltephase_Getri, 4=ID_FN_RQ_BUS_Standheizung_Standlueften, 3=ID_FN_RQ_BUS_Restwaermefunktion, 2=ID_FN_RQ_BUS_Remote_Services, 1=ID_FN_RQ_BUS_Entertainmentfunktion
  compu method comIdRqBus_Semantic: 5=ID_RQ_BUS_Signal_ungueltig, 1=ID_RQ_BUS_Teilnetz__Klemme_30F, 0=ID_RQ_BUS_Teilnetz__Klemme_30g__bis_PL6
  compu method comStRqBus_Semantic: 5=ST_RQ_BUS_Signal_ungueltig, 4=ST_RQ_BUS_Restart_Nachlaufzeit, 2=ST_RQ_BUS_Aus, 1=ST_RQ_BUS_Reset, 0=ST_RQ_BUS_Aktivieren
  compu method comStLawRq_Semantic: 5=ST_LAW_RQ_Signal_ungueltig, 1=ST_LAW_RQ_gesetzlich, 0=ST_LAW_RQ_nicht_gesetzlich
  compu method comIdFnInqy_Semantic: 5=ID_FN_INQY_Signal_ungueltig, 3=ID_FN_INQY_Status_Laderaumabdeckung_CKM, 9=ID_FN_INQY_Status_Licht_Erweitert_CKM, 7=ID_FN_INQY_Status_Rueckfahrkamera_CKM, 5=ID_FN_INQY_Status_Heckklappe_CKM, 3=ID_FN_INQY_Status_ALC_CKM, 1=ID_FN_INQY_Status_Klima_CKM, 9=ID_FN_INQY_Status_Licht_CKM, 7=ID_FN_INQY_Status_Memorypositionen_CKM, 5=ID_FN_INQY_Status_RLS_CKM, 3=ID_FN_INQY_Status_DWA_CKM, 1=ID_FN_INQY_Status_Zentralverriegelung_CKM, 6=ID_FN_INQY_Status_Spurverlassenswarnsystem, 4=ID_FN_INQY_Status_EDCK_CKM, 3=ID_FN_INQY_Konfiguration_BFSH, 2=ID_FN_INQY_Konfiguration_FASH, 1=ID_FN_INQY_Konfiguration_BFS, 0=ID_FN_INQY_Konfiguration_FAS, 9=ID_FN_INQY_Position_Fensterheber_Heckscheib, 6=ID_FN_INQY_Position_Fensterheber_Sicherheit, 4=ID_FN_INQY_Position_SHD, 3=ID_FN_INQY_Position_Fensterheber_BFTH, 2=ID_FN_INQY_Position_Fensterheber_BFT, 1=ID_FN_INQY_Position_Fensterheber_FATH, 0=ID_FN_INQY_Position_Fensterheber_FAT, 9=ID_FN_INQY_Status_Shiftlights_CKM, 7=ID_FN_INQY_Status_Motorsteuerung_CKM, 1=ID_FN_INQY_Status_M_Drive, 7=ID_FN_INQY_Codierung_Powermanagement, 0=ID_FN_INQY_Startdrehzahl, 4=ID_FN_INQY_Fahrzeugtyp, 8=ID_FN_INQY_Elektronischer_Motoroelmessstab_M, 7=ID_FN_INQY_Elektronischer_Motoroelmessstab, 6=ID_FN_INQY_Fahrgestellnummer, 4=ID_FN_INQY_Daten_Bordcomputer_Fahrtbeginn, 0=ID_FN_INQY_Status_Bordcomputer, 1=ID_FN_INQY_Rohdaten_Fuellstand_Tank, 3=ID_FN_INQY_Status_Kartendaten, 0=ID_FN_INQY_Status_Monitor_Fond_2, 8=ID_FN_INQY_Status_Monitor_Fond_1, 6=ID_FN_INQY_Status_Monitor_Front, 2=ID_FN_INQY_Anzeige_Checkcontrol_Meldung_Ro, 7=ID_FN_INQY_Status_Service_Call_Teleservice, 3=ID_FN_INQY_Status_Service_Call_TeleX, 8=ID_FN_INQY_Status_RSE, 0=ID_FN_INQY_Uhrzeit_Datum, 9=ID_FN_INQY_Einheiten, 2=ID_FN_INQY_Status_Klima_Standfunktionen, 0=ID_FN_INQY_Status_Klima_Zusatzprogramme, 8=ID_FN_INQY_Status_Klima_SH_ZH_Zusatzwasserp, 6=ID_FN_INQY_Status_Klima_Luftverteilung_BF, 2=ID_FN_INQY_Status_Klima_Luftverteilung_FA, 7=ID_FN_INQY_Bedienung_Einheiten, 8=ID_FN_INQY_Status_Verdeck_Cabrio, 5=ID_FN_INQY_Bedienung_Tastgeber_Bedienelemen, 4=ID_FN_INQY_Wischerstatus, 4=ID_FN_INQY_Status_Rueckfahrkamera, 0=ID_FN_INQY_Status_Funkschluessel, 0=ID_FN_INQY_Regensensor_Wischergeschwindigke, 5=ID_FN_INQY_Position_Lenksaeule, 0=ID_FN_INQY_Effekt_FondCommander, 6=ID_FN_INQY_Effekt_ErgoCommander, 6=ID_FN_INQY_Steuerung_Aussenspiegel, 1=ID_FN_INQY_Bedienung_Tasten_Entertainment
  compu method comVWi_Semantic: 5=V_WI_Signal_ungueltig, 0=V_WI_Wischer_ausschalten
  compu method comStRnse_Semantic: 5=ST_RNSE_Signal_ungueltig
  compu method comIntmT_Semantic: 5=INTM_T_Signal_ungueltig, 4=INTM_T_Nicht_wischen_Pause, 0=INTM_T_Sofort_loswischen
  compu method comStEcuVVeh_Semantic: 5=ST_ECU_V_VEH_Signal_ungueltig, 4=ST_ECU_V_VEH_Zustand_Reserviert_14, 3=ST_ECU_V_VEH_Zustand_Reserviert_13, 2=ST_ECU_V_VEH_Zustand_Reserviert_12, 1=ST_ECU_V_VEH_Zustand_Reserviert_11, 0=ST_ECU_V_VEH_Zustand_Reset, 9=ST_ECU_V_VEH_Zustand_Nicht_verfuegbar, 8=ST_ECU_V_VEH_Zustand_PowerSave, 7=ST_ECU_V_VEH_Zustand_Powerdown, 6=ST_ECU_V_VEH_Zustand_Diagnose_Unterspannung_s, 5=ST_ECU_V_VEH_Zustand_Diagnose_Ueberspannung_se, 4=ST_ECU_V_VEH_Zustand_Diagnose, 3=ST_ECU_V_VEH_Zustand_Normalbetrieb_Unterspann, 2=ST_ECU_V_VEH_Zustand_Normalbetrieb_Ueberspannu, 1=ST_ECU_V_VEH_Zustand_Normalbetrieb, 0=ST_ECU_V_VEH_Zustand_Initialisierung
  compu method comQuVVehCog_Semantic: 5=QU_V_VEH_COG_Signal_ungueltig, 7=QU_V_VEH_COG_Sensor_nicht_vorhanden, 4=QU_V_VEH_COG_Signalwert_ist_ungueltig_Zustand, 2=QU_V_VEH_COG_Abgleichwert_ist_im_Nutzsignal_g, 4=QU_V_VEH_COG_Ersatzwert_ist_im_Nutzsignal_ges, 1=QU_V_VEH_COG_Signalqualitaet_bzw_Ueberwachung, 0=QU_V_VEH_COG_Signalwert_ist_gueltig_Zustand_S, 9=QU_V_VEH_COG_Signalwert_ist_gueltig_und_abgesi, 8=QU_V_VEH_COG_Initialisierung
  compu method comDvcoVeh_Semantic: 7=DVCO_VEH_Signal_ungueltig, 4=DVCO_VEH_Fahrzeug_steht_Hinterachse_auf, 3=DVCO_VEH_Fahrzeug_faehrt, 2=DVCO_VEH_Fahrzeug_faehrt_rueckwaerts, 1=DVCO_VEH_Fahrzeug_faehrt_vorwaerts, 0=DVCO_VEH_Fahrzeug_steht
  compu method comAlivVVeh_Semantic: 5=ALIV_V_VEH_Signal_ungueltig
  compu method comQuAvlRpmEngCrsh_Semantic: 5=QU_AVL_RPM_ENG_CRSH_Signal_ungueltig, 7=QU_AVL_RPM_ENG_CRSH_Sensor_nicht_vorhanden, 4=QU_AVL_RPM_ENG_CRSH_Signalwert_ist_ungueltig_Zustand, 2=QU_AVL_RPM_ENG_CRSH_Abgleichwert_ist_im_Nutzsignal_g, 4=QU_AVL_RPM_ENG_CRSH_Ersatzwert_ist_im_Nutzsignal_ges, 1=QU_AVL_RPM_ENG_CRSH_Signalqualitaet_bzw_Ueberwachung, 0=QU_AVL_RPM_ENG_CRSH_Signalwert_ist_gueltig_Zustand_S, 9=QU_AVL_RPM_ENG_CRSH_Signalwert_ist_gueltig_und_abgesi, 8=QU_AVL_RPM_ENG_CRSH_Initialisierung
  compu method comAlivTorqCrsh1_Semantic: 5=ALIV_TORQ_CRSH_1_Signal_ungueltig
  compu method comOpWiswSzlLin_Semantic: 0=OP_WISW_SZL_LIN_Keine_Aktion, 255=OP_WISW_SZL_LIN_Signal_ungueltig
  compu method comOpWipoSzlLin_Semantic: 0=OP_WIPO_SZL_LIN_Stufe_1, 1=OP_WIPO_SZL_LIN_Stufe_2, 2=OP_WIPO_SZL_LIN_Stufe_3, 4=OP_WIPO_SZL_LIN_Stufe_4, 7=OP_WIPO_SZL_LIN_Signal_ungueltig
  compu method comAlivWiswSzlLin_Semantic: 15=ALIV_WISW_SZL_LIN_Signal_ungueltig
  compu method comCommErrSzlLin_Semantic: 0=COMM_ERR_SZL_LIN_kein_Fehler, 1=COMM_ERR_SZL_LIN_Fehler_aktiv
  compu method comOpColsSzlLin_Semantic: 0=OP_COLS_SZL_LIN_Keine_Aktion, 255=OP_COLS_SZL_LIN_Signal_ungueltig
  compu method comStPubuMabAsstSzlLin_Semantic: 0=ST_PUBU_MAB_ASST_SZL_LIN_Taster_nicht_betaetigt, 1=ST_PUBU_MAB_ASST_SZL_LIN_Taster_betaetigt, 3=ST_PUBU_MAB_ASST_SZL_LIN_Signal_ungueltig
  compu method comOpPubuHootSzlLin_Semantic: 0=OP_PUBU_HOOT_SZL_LIN_Taster_nicht_betaetigt, 1=OP_PUBU_HOOT_SZL_LIN_Taster_betaetigt, 3=OP_PUBU_HOOT_SZL_LIN_Signal_ungueltig
  compu method comStStwhSzlLin_Semantic: 0=ST_STWH_SZL_LIN_Taster_nicht_betaetigt, 1=ST_STWH_SZL_LIN_Taster_betaetigt, 3=ST_STWH_SZL_LIN_Signal_ungueltig
  compu method comNodErrSzlLin_Semantic: 0=NOD_ERR_SZL_LIN_Kein_Fehler, 1=NOD_ERR_SZL_LIN_Fehler_aktiv, 2=NOD_ERR_SZL_LIN_Fehler_Statusaenderung, 3=NOD_ERR_SZL_LIN_Signal_ungueltig
  compu method comCrcCctrStwLin_Semantic: raw=(1)/(1) for phys 0..255
  compu method comOpPubuTelStwLin_Semantic: 0=OP_PUBU_TEL_STW_LIN_Keine_Aktion, 1=OP_PUBU_TEL_STW_LIN_Taster_TEL_gedrueckt, 3=OP_PUBU_TEL_STW_LIN_Signal_ungueltig
  compu method comErrStStwLin_Semantic: 0=ERR_ST_STW_LIN_Kein_Fehler, 1=ERR_ST_STW_LIN_Schalterblock_links_defekt, 2=ERR_ST_STW_LIN_Schalterblock_rechts_defekt, 4=ERR_ST_STW_LIN_Tippraendel_Widerspruch, 8=ERR_ST_STW_LIN_Raendel_Widerspruch, 16=ERR_ST_STW_LIN_Wippe_Widerspruch, 63=ERR_ST_STW_LIN_Signal_ungueltig; raw=(1)/(1) for phys 3, raw=(1)/(1) for phys 5..7, raw=(1)/(1) for phys 9..15, raw=(1)/(1) for phys 17..62
  compu method comOpPubuPttStwLin_Semantic: 0=OP_PUBU_PTT_STW_LIN_Keine_Aktion, 1=OP_PUBU_PTT_STW_LIN_PTT_Taster_gedrueckt, 3=OP_PUBU_PTT_STW_LIN_Signal_ungueltig
  compu method comOpPubuAudAvolStwLin_Semantic: 0=OP_PUBU_AUD_AVOL_STW_LIN_Keine_Aktion, 1=OP_PUBU_AUD_AVOL_STW_LIN_Lautstaerke_leiser, 2=OP_PUBU_AUD_AVOL_STW_LIN_Lautstaerke_lauter, 3=OP_PUBU_AUD_AVOL_STW_LIN_Signal_ungueltig
  compu method comOpPubuSpfnLin_Semantic: 0=OP_PUBU_SPFN_LIN_Keine_Aktion, 1=OP_PUBU_SPFN_LIN_Taster_gedrueckt, 3=OP_PUBU_SPFN_LIN_Signal_ungueltig
  compu method comOpPubuKrlStwLin_Semantic: 0=OP_PUBU_KRL_STW_LIN_Keine_Aktion, 1=OP_PUBU_KRL_STW_LIN_Taster_gedrueckt, 3=OP_PUBU_KRL_STW_LIN_Signal_ungueltig
  compu method comOpCctrOpel1Lin_Semantic: 0=OP_CCTR_OPEL_1_LIN_Neutralstellung, 1=OP_CCTR_OPEL_1_LIN_Stellung_aktiv, 2..6=OP_CCTR_OPEL_1_LIN_Nicht_belegt, 15=OP_CCTR_OPEL_1_LIN_Signal_ungueltig
  compu method comOpCctrOpel2Lin_Semantic: 0=OP_CCTR_OPEL_2_LIN_Neutralstellung, 1=OP_CCTR_OPEL_2_LIN_Stellung_aktiv, 2..6=OP_CCTR_OPEL_2_LIN_Nicht_belegt, 15=OP_CCTR_OPEL_2_LIN_Signal_ungueltig
  compu method comOpCctrOpel3Lin_Semantic: 0=OP_CCTR_OPEL_3_LIN_Neutralstellung, 1=OP_CCTR_OPEL_3_LIN_Stellung_aktiv_vorne, 2=OP_CCTR_OPEL_3_LIN_Stellung_aktiv_vorne, 3=OP_CCTR_OPEL_3_LIN_Nicht_belegt, 4=OP_CCTR_OPEL_3_LIN_Nicht_belegt, 5=OP_CCTR_OPEL_3_LIN_Stellung_aktiv_hinten, 6=OP_CCTR_OPEL_3_LIN_Stellung_aktiv_hinten, 15=OP_CCTR_OPEL_3_LIN_Signal_ungueltig
  compu method comOpCctrOpel4Lin_Semantic: 0=OP_CCTR_OPEL_4_LIN_Neutralstellung, 1=OP_CCTR_OPEL_4_LIN_Stellung_aktiv, 2..6=OP_CCTR_OPEL_4_LIN_Nicht_belegt, 15=OP_CCTR_OPEL_4_LIN_Signal_ungueltig
  compu method comOpCctrOpel5Lin_Semantic: 0=OP_CCTR_OPEL_5_LIN_Neutralstellung, 1=OP_CCTR_OPEL_5_LIN_Stellung_aktiv, 2=OP_CCTR_OPEL_5_LIN_Nicht_belegt, 3=OP_CCTR_OPEL_5_LIN_Nicht_belegt, 4=OP_CCTR_OPEL_5_LIN_Nicht_belegt, 5=OP_CCTR_OPEL_5_LIN_Stellung_aktiv, 6=OP_CCTR_OPEL_5_LIN_Nicht_belegt, 15=OP_CCTR_OPEL_5_LIN_Signal_ungueltig
  compu method comOpCctrOpel6Lin_Semantic: 0=OP_CCTR_OPEL_6_LIN_Neutralstellung, 1=OP_CCTR_OPEL_6_LIN_Stellung_aktiv, 2..6=OP_CCTR_OPEL_6_LIN_Nicht_belegt, 15=OP_CCTR_OPEL_6_LIN_Signal_ungueltig
  compu method comErrStIntlStwLin_Semantic: 0=ERR_ST_INTL_STW_LIN_Kein_Fehler, 1=ERR_ST_INTL_STW_LIN_Fehler_aktiv, 3=ERR_ST_INTL_STW_LIN_Signal_ungueltig
  compu method comCommErrStwLin_Semantic: 0=COMM_ERR_STW_LIN_kein_Fehler, 1=COMM_ERR_STW_LIN_Fehler_aktiv
  compu method comStOpStepsKrlStwLin_Semantic: 15=ST_OP_STEPS_KRL_STW_LIN_Signal_ungueltig
  compu method comDirrtKrlStwLin_Semantic: 0=DIRRT_KRL_STW_LIN_Keine_Aktion, 1=DIRRT_KRL_STW_LIN_Richtung, 2=DIRRT_KRL_STW_LIN_Richtung, 3=DIRRT_KRL_STW_LIN_Signal_ungueltig
  compu method comVWiLin_Semantic: 0=V_WI_LIN_Wischer_ausschalten, 15=V_WI_LIN_Signal_ungueltig
  compu method comStRnseLin_Semantic: 15=ST_RNSE_LIN_Signal_ungueltig
  compu method comStLowbReasLin_Semantic: 255=ST_LOWB_REAS_LIN_Signal_ungueltig
  compu method comStVlLowbLin_Semantic: 255=ST_VL_LOWB_LIN_Signal_ungueltig
  compu method comIntRnLin_Semantic: 255=INT_RN_LIN_Signal_ungueltig
  compu method comStLowbLin_Semantic: 0=ST_LOWB_LIN_Fahrlicht_ausschalten, 1=ST_LOWB_LIN_Fahrlicht_einschalten, 3=ST_LOWB_LIN_Signal_ungueltig
  compu method comStSenLowbLin_Semantic: 0=ST_SEN_LOWB_LIN_In_Ordnung, 1=ST_SEN_LOWB_LIN_Defekt, 3=ST_SEN_LOWB_LIN_Signal_ungueltig
  compu method comNodErrRlsLin_Semantic: 0=NOD_ERR_RLS_LIN_Kein_Fehler, 1=NOD_ERR_RLS_LIN_Fehler_aktiv, 2=NOD_ERR_RLS_LIN_Fehler_Statusaenderung, 3=NOD_ERR_RLS_LIN_Signal_ungueltig
  compu method comCommErrRlsLin_Semantic: 0=COMM_ERR_RLS_LIN_kein_Fehler, 1=COMM_ERR_RLS_LIN_Fehler_aktiv
  compu method comDtPsenRfciCo2Lin_Semantic: 4093=DT_PSEN_RFCI_CO2_LIN_Sensor_Defekt, 4094=DT_PSEN_RFCI_CO2_LIN_Initialisierung, 4095=DT_PSEN_RFCI_CO2_LIN_Signal_ungueltig; raw=(1)/(1) for phys 0..2000, raw=(1)/(1) for phys 2001..4092
  compu method comTempRfciCo2Lin_Semantic: 4093=TEMP_RFCI_CO2_LIN_Sensor_Defekt, 4094=TEMP_RFCI_CO2_LIN_Initialisierung, 4095=TEMP_RFCI_CO2_LIN_Signal_ungueltig; raw=(1)/(1) for phys 0..480, raw=(1)/(1) for phys 481..4092
  compu method comCommErrPtSenLin_Semantic: 0=COMM_ERR_PT_SEN_LIN_kein_Fehler, 1=COMM_ERR_PT_SEN_LIN_Fehler_aktiv
  compu method comStFnWellRear_Semantic: 15=ST_FN_WELL_REAR_Signal_ung_ltig, 14=ST_FN_WELL_REAR_ERROR, 6=ST_FN_WELL_REAR_WELL_MODE_4, 5=ST_FN_WELL_REAR_WELL_MODE_3, 4=ST_FN_WELL_REAR_WELL_MODE_2, 3=ST_FN_WELL_REAR_WELL_MODE_1, 1=ST_FN_WELL_REAR_OFF_WELL, 0=ST_FN_WELL_REAR_INIT
  compu method comStFnRvlpRear_Semantic: 15=ST_FN_RVLP_REAR_Signal_ung_ltig, 14=ST_FN_RVLP_REAR_ERROR, 2=ST_FN_RVLP_REAR_ON_RVLI, 1=ST_FN_RVLP_REAR_OFF_RVLI, 0=ST_FN_RVLP_REAR_INIT
  compu method comStFnRflpRear_Semantic: 15=ST_FN_RFLP_REAR_Signal_ung_ltig, 14=ST_FN_RFLP_REAR_ERROR, 9=ST_FN_RFLP_REAR_ON_RFLI_ASYNC, 8=ST_FN_RFLP_REAR_ON_RFLI_SYNC, 2=ST_FN_RFLP_REAR_ON_RFLI, 1=ST_FN_RFLP_REAR_OFF_RFLI, 0=ST_FN_RFLP_REAR_INIT
  compu method comStFnPoliRear_Semantic: 15=ST_FN_POLI_REAR_Signal_ung_ltig, 14=ST_FN_POLI_REAR_ERROR_POLI, 4=ST_FN_POLI_REAR_POLI__MODUS3, 3=ST_FN_POLI_REAR_POLI__MODUS2, 2=ST_FN_POLI_REAR_POLI_MODUS1, 1=ST_FN_POLI_REAR_OFF_POLI, 0=ST_FN_POLI_REAR_INIT
  compu method comStFnPliRear_Semantic: 15=ST_FN_PLI_REAR_Signal_ung_ltig, 14=ST_FN_PLI_REAR_ERROR, 3=ST_FN_PLI_REAR_ON_RPLI_R, 2=ST_FN_PLI_REAR_ON_RPLI_L, 1=ST_FN_PLI_REAR_OFF_RPLI, 0=ST_FN_PLI_REAR_INIT
  compu method comStFnIdcRhRear_Semantic: 15=ST_FN_IDC_RH_REAR_Signal_ung_ltig, 14=ST_FN_IDC_RH_REAR_ERROR, 3=ST_FN_IDC_RH_REAR_ON_IDC_R_0, 2=ST_FN_IDC_RH_REAR_ON_IDC_R_1, 1=ST_FN_IDC_RH_REAR_OFF_IDC_R, 0=ST_FN_IDC_RH_REAR_INIT
  compu method comStFnIdcLhRear_Semantic: 15=ST_FN_IDC_LH_REAR_Signal_ung_ltig, 14=ST_FN_IDC_LH_REAR_ERROR, 3=ST_FN_IDC_LH_REAR_ON_IDC_L_0, 2=ST_FN_IDC_LH_REAR_ON_IDC_L_1, 1=ST_FN_IDC_LH_REAR_OFF_IDC_L, 0=ST_FN_IDC_LH_REAR_INIT
  compu method comStFnFmhRear_Semantic: 15=ST_FN_FMH_REAR_Signal_ung_ltig, 14=ST_FN_FMH_REAR_ERROR, 2=ST_FN_FMH_REAR_ON_FMH, 1=ST_FN_FMH_REAR_OFF_FMH, 0=ST_FN_FMH_REAR_INIT
  compu method comStFnDrlRear_Semantic: 15=ST_FN_DRL_REAR_Signal_ung_ltig, 14=ST_FN_DRL_REAR_ERROR, 2=ST_FN_DRL_REAR_ON_DRL, 1=ST_FN_DRL_REAR_OFF_DRL, 0=ST_FN_DRL_REAR_INIT
  compu method comStFnBlRear_Semantic: 15=ST_FN_BL_REAR_Signal_ung_ltig, 14=ST_FN_BL_REAR_ERROR, 2=ST_FN_BL_REAR_ON_BL, 1=ST_FN_BL_REAR_OFF_BL, 0=ST_FN_BL_REAR_INIT
  compu method comStFnBfdRear_Semantic: 15=ST_FN_BFD_REAR_Signal_ung_ltig, 14=ST_FN_BFD_REAR_ERROR, 5=ST_FN_BFD_REAR_BFD_MODE_4, 4=ST_FN_BFD_REAR_BFD_MODE_3, 3=ST_FN_BFD_REAR_BFD_MODE_2, 2=ST_FN_BFD_REAR_BFD_MODE_1, 1=ST_FN_BFD_REAR_OFF_BFD, 0=ST_FN_BFD_REAR_INIT
  compu method comAlivStLpExRear_Semantic: 15=ALIV_ST_LP_EX_REAR_Signal_ung_ltig
  compu method comStRdiHud_Semantic: 3=ST_RDI_HUD_Signal_ungueltig, 2=ST_RDI_HUD_Bilddaten_vorhanden, 1=ST_RDI_HUD_Bilddaten_nicht_vorhanden
  compu method comStHgadHud2_Semantic: 5=ST_HGAD_HUD_2_Signal_ungueltig
  compu method comStBrigOffsHud2_Semantic: 5=ST_BRIG_OFFS_HUD_2_Signal_ungueltig
  compu method comStBalHud_Semantic: 3=ST_BAL_HUD_Signal_ungueltig, 2=ST_BAL_HUD_Backlight_ein, 1=ST_BAL_HUD_Backlight_aus
  compu method comStCtScaLcl_Semantic: 3=ST_CT_SCA_LCL_Signal_ungueltig, 2=ST_CT_SCA_LCL_Signal_unplausibel, 1=ST_CT_SCA_LCL_SCA_Vorraste_ist_offen, 0=ST_CT_SCA_LCL_SCA_Vorraste_ist_geschlossen
  compu method comStCtRscrLcl_Semantic: 3=ST_CT_RSCR_LCL_Signal_ungueltig, 2=ST_CT_RSCR_LCL_Signal_unplausibel, 1=ST_CT_RSCR_LCL_Heckscheibe_ist_offen, 0=ST_CT_RSCR_LCL_Heckscheibe_ist_geschlossen
  compu method comStCtBtlLcl_Semantic: 3=ST_CT_BTL_LCL_Signal_ungueltig, 2=ST_CT_BTL_LCL_Signal_unplausibel, 1=ST_CT_BTL_LCL_HK_ist_offen, 0=ST_CT_BTL_LCL_HK_ist_geschlossen
  compu method comStClsyRplkRscr_Semantic: 3=ST_CLSY_RPLK_RSCR_Signal_ungueltig, 1=ST_CLSY_RPLK_RSCR_Wiederholsperre_aktiv, 0=ST_CLSY_RPLK_RSCR_Keine_Wiederholsperre
  compu method comStClsyRplkBtl_Semantic: 3=ST_CLSY_RPLK_BTL_Signal_ungueltig, 1=ST_CLSY_RPLK_BTL_Wiederholsperre_aktiv, 0=ST_CLSY_RPLK_BTL_Keine_Wiederholsperre
  compu method comOpPubuDhdRscrLcl_Semantic: 3=OP_PUBU_DHD_RSCR_LCL_Signal_ungueltig, 1=OP_PUBU_DHD_RSCR_LCL_Heckscheibentaster_aussen_wurde_b, 0=OP_PUBU_DHD_RSCR_LCL_Keine_Aktion
  compu method comOpPubuDhdBtlLcl_Semantic: 3=OP_PUBU_DHD_BTL_LCL_Signal_ungueltig, 1=OP_PUBU_DHD_BTL_LCL_Heckklappentaster_aussen_wurde_be, 0=OP_PUBU_DHD_BTL_LCL_Keine_Aktion
  compu method comStSrcOpCabrf_Semantic: 5=ST_SRC_OP_CABRF_Signal_ungueltig, 6=ST_SRC_OP_CABRF_Fernbedienung, 8=ST_SRC_OP_CABRF_ID_Geber, 4=ST_SRC_OP_CABRF_Tuerschloss, 2=ST_SRC_OP_CABRF_Bedienschalter_schliessen, 1=ST_SRC_OP_CABRF_Bedienschalter_oeffnen, 0=ST_SRC_OP_CABRF_Keine_Bedienung
  compu method comStPoCabrf_Semantic: 5=ST_PO_CABRF_Signal_ungueltig, 7=ST_PO_CABRF_Notverriegelung_durchgefuehrt, 6=ST_PO_CABRF_Komplett_geoeffnet, 5=ST_PO_CABRF_Komplett_geschlossen, 4=ST_PO_CABRF_Hardtop_aufgesetzt, 3=ST_PO_CABRF_Beladeposition, 2=ST_PO_CABRF_Komplett_geoeffnet_und_verriegelt, 1=ST_PO_CABRF_Zwischenstellung, 0=ST_PO_CABRF_Komplett_geschlossen_und_verrieg
  compu method comStActiCabrf_Semantic: 5=ST_ACTI_CABRF_Signal_ungueltig, 6=ST_ACTI_CABRF_Klappen_und_Dachhydraulik_aktiv, 4=ST_ACTI_CABRF_Klappenhydraulik_aktiv, 2=ST_ACTI_CABRF_Dachhydraulik_aktiv, 1=ST_ACTI_CABRF_Verriegelungsmotor_aktiv, 0=ST_ACTI_CABRF_Keine_Ansteuerung
  compu method comStSeatOccuRrh_Semantic: 7=ST_SEAT_OCCU_RRH_Signal_ungueltig, 6=ST_SEAT_OCCU_RRH_Wert_Initialisierung, 4=ST_SEAT_OCCU_RRH_Erkennungssystem_nicht_vorhanden, 3=ST_SEAT_OCCU_RRH_Sitz_belegt, 0=ST_SEAT_OCCU_RRH_Sitz_nicht_belegt
  compu method comStSeatOccuRlh_Semantic: 7=ST_SEAT_OCCU_RLH_Signal_ungueltig, 6=ST_SEAT_OCCU_RLH_Wert_Initialisierung, 4=ST_SEAT_OCCU_RLH_Erkennungssystem_nicht_vorhanden, 3=ST_SEAT_OCCU_RLH_Sitz_belegt, 0=ST_SEAT_OCCU_RLH_Sitz_nicht_belegt
  compu method comStSeatOccuPs_Semantic: 1=ST_SEAT_OCCU_PS_Sitz_mit_Kindersitz_belegt, 7=ST_SEAT_OCCU_PS_Signal_ungueltig, 6=ST_SEAT_OCCU_PS_Wert_Initialisierung, 4=ST_SEAT_OCCU_PS_Erkennungssystem_nicht_vorhanden, 3=ST_SEAT_OCCU_PS_Sitz_belegt, 0=ST_SEAT_OCCU_PS_Sitz_nicht_belegt
  compu method comStSeatOccuDr_Semantic: 7=ST_SEAT_OCCU_DR_Signal_ungueltig, 6=ST_SEAT_OCCU_DR_Wert_Initialisierung, 4=ST_SEAT_OCCU_DR_Erkennungssystem_nicht_vorhanden, 3=ST_SEAT_OCCU_DR_Sitz_belegt, 0=ST_SEAT_OCCU_DR_Sitz_nicht_belegt
  compu method comStErrSeatMtDr_Semantic: 7=ST_ERR_SEAT_MT_DR_Signal_ungueltig, 6=ST_ERR_SEAT_MT_DR_Kein_Fehler, 2=ST_ERR_SEAT_MT_DR_Unterbrechung_Kurzschluss_der_Si, 1=ST_ERR_SEAT_MT_DR_Kommunikationsstoerung_sendet_ni, 0=ST_ERR_SEAT_MT_DR_Plausibilitaetsfehler
  compu method comStBltbSwRrh_Semantic: 3=ST_BLTB_SW_RRH_Signal_ungueltig, 2=ST_BLTB_SW_RRH_Schalter_Gurtschloss_nicht_verba, 1=ST_BLTB_SW_RRH_Schalter_Gurtschloss_gesteckt, 0=ST_BLTB_SW_RRH_Schalter_Gurtschloss_nicht_geste
  compu method comStBltbSwRm_Semantic: 3=ST_BLTB_SW_RM_Signal_ungueltig, 2=ST_BLTB_SW_RM_Schalter_Gurtschloss_nicht_verba, 1=ST_BLTB_SW_RM_Schalter_Gurtschloss_gesteckt, 0=ST_BLTB_SW_RM_Schalter_Gurtschloss_nicht_geste
  compu method comStBltbSwRlh_Semantic: 3=ST_BLTB_SW_RLH_Signal_ungueltig, 2=ST_BLTB_SW_RLH_Schalter_Gurtschloss_nicht_verba, 1=ST_BLTB_SW_RLH_Schalter_Gurtschloss_gesteckt, 0=ST_BLTB_SW_RLH_Schalter_Gurtschloss_nicht_geste
  compu method comStBltbSwPs_Semantic: 3=ST_BLTB_SW_PS_Signal_ungueltig, 2=ST_BLTB_SW_PS_Schalter_Gurtschloss_nicht_verba, 1=ST_BLTB_SW_PS_Schalter_Gurtschloss_gesteckt, 0=ST_BLTB_SW_PS_Schalter_Gurtschloss_nicht_geste
  compu method comStBltbSwDr_Semantic: 3=ST_BLTB_SW_DR_Signal_ungueltig, 2=ST_BLTB_SW_DR_Schalter_Gurtschloss_nicht_verba, 1=ST_BLTB_SW_DR_Schalter_Gurtschloss_gesteckt, 0=ST_BLTB_SW_DR_Schalter_Gurtschloss_nicht_geste
  compu method comAlivCouStBltCtSoccu_Semantic: 5=ALIV_COU_ST_BLT_CT_SOCCU_Signal_ungueltig
  compu method comStGrBac_Semantic: 3=ST_GR_BAC_Signal_ungueltig, 2=ST_GR_BAC_Rueckwaertsgang, 1=ST_GR_BAC_kein_Rueckwaertsgang
  compu method comStLokRqFfbLfsr_Semantic: 3=ST_LOK_RQ_FFB_LFSR_Signal_ungueltig, 2=ST_LOK_RQ_FFB_LFSR_FFB_im_Nahbereich_detektiert_be, 1=ST_LOK_RQ_FFB_LFSR_FFB_nicht_im_Nahbereich_detektie, 0=ST_LOK_RQ_FFB_LFSR_keine_Erkennung_angestossen
  compu method comStKeyRmc_Semantic: 3=ST_KEY_RMC_Signal_ungueltig, 2=ST_KEY_RMC_Reserviert, 1=ST_KEY_RMC_Kein_Fernbedienungsschluessel, 0=ST_KEY_RMC_Fernbedienungsschluessel
  compu method comStKeyBtDispMmi_Semantic: 5=ST_KEY_BT_DISP_MMI_Signal_ungueltig, 4=ST_KEY_BT_DISP_MMI_aktivieren, 0=ST_KEY_BT_DISP_MMI_Init_Wert
  compu method comStKeyBt_Semantic: 3=ST_KEY_BT_Signal_ungueltig, 1=ST_KEY_BT_Unterspannung_liegt_vor, 0=ST_KEY_BT_Batterie_in_Ordnung
  compu method comOpKeyLdpoFldt_Semantic: 3=OP_KEY_LDPO_FLDT_Signal_ungueltig, 1=OP_KEY_LDPO_FLDT_Anforderung_Lade_Position, 0=OP_KEY_LDPO_FLDT_Keine_Anforderung
  compu method comOpKeyButSpfn_Semantic: 3=OP_KEY_BUT_SPFN_Signal_ungueltig, 2=OP_KEY_BUT_SPFN_Taste_laenger_als_Panic_Zeit_betae, 1=OP_KEY_BUT_SPFN_Taste_kuerzer_als_Panic_Zeit_betae, 0=OP_KEY_BUT_SPFN_Taste_nicht_betaetigt
  compu method comOpKeyButBtl_Semantic: 3=OP_KEY_BUT_BTL_Signal_ungueltig, 1=OP_KEY_BUT_BTL_Taste_betaetigt, 0=OP_KEY_BUT_BTL_Taste_nicht_betaetigt
  compu method comNoKeyTrPrsl_Semantic: 5=NO_KEY_TR_PRSL_Signal_ungueltig, 4=NO_KEY_TR_PRSL_Defaultbereich, 0=NO_KEY_TR_PRSL_1_unpersonalisierter_Bereich_P
  compu method comNoKeyPrsl_Semantic: 5=NO_KEY_PRSL_Signal_ungueltig, 4=NO_KEY_PRSL_Defaultbereich, 0=NO_KEY_PRSL_1_unpersonalisierter_Bereich_P, 3=NO_KEY_PRSL_Schluesselnummer_3, 2=NO_KEY_PRSL_Schluesselnummer_2, 1=NO_KEY_PRSL_Schluesselnummer_1, 0=NO_KEY_PRSL_Schluesselnummer_0
  compu method comCtrUgdo_Semantic: 3=CTR_UGDO_Signal_ungueltig, 1=CTR_UGDO_aktivieren, 0=CTR_UGDO_nicht_aktivieren
  compu method comCtrTrPrsl_Semantic: 3=CTR_TR_PRSL_Signal_ungueltig, 2=CTR_TR_PRSL_Personalisierungsdaten_speichern, 1=CTR_TR_PRSL_Personalisierungsdaten_abrufen, 0=CTR_TR_PRSL_Keine_Aktion
  compu method comCtrLpFmh_Semantic: 3=CTR_LP_FMH_Signal_ungueltig, 1=CTR_LP_FMH_aktivieren, 0=CTR_LP_FMH_nicht_aktivieren
  compu method comCtrItliPlip_Semantic: 3=CTR_ITLI_PLIP_Signal_ungueltig, 1=CTR_ITLI_PLIP_Trigger_Innenlicht_EIN, 0=CTR_ITLI_PLIP_Keine_Aktion
  compu method comStTarPengCeng_Semantic: 3=ST_TAR_PENG_CENG_Signal_ungueltig, 1=ST_TAR_PENG_CENG_Kraftschluss, 0=ST_TAR_PENG_CENG_kein_Kraftschluss
  compu method comStShftMsaEngstp_Semantic: 7=ST_SHFT_MSA_ENGSTP_Signal_ungueltig, 4=ST_SHFT_MSA_ENGSTP_Motor_aus, 3=ST_SHFT_MSA_ENGSTP_Einschaltverhinderer_ein, 2=ST_SHFT_MSA_ENGSTP_Ausschaltverhinderer_ein, 0=ST_SHFT_MSA_ENGSTP_Init
  compu method comStFnMsa_Semantic: 3=ST_FN_MSA_Signal_ungueltig, 1=ST_FN_MSA_MSA_aktiviert, 0=ST_FN_MSA_MSA_deaktiviert
  compu method comSpecTypEngsta_Semantic: 5=SPEC_TYP_ENGSTA_Signal_ungueltig, 3=SPEC_TYP_ENGSTA_Start_durch_ZSE_und_EM, 2=SPEC_TYP_ENGSTA_Start_nur_durch_EM, 1=SPEC_TYP_ENGSTA_Start_nur_durch_ZSE, 0=SPEC_TYP_ENGSTA_Kein_Motorstart_angefordert
  compu method comRqMsaEngSta2_Semantic: 3=RQ_MSA_ENG_STA_2_Signal_ungueltig, 2=RQ_MSA_ENG_STA_2_Motor_starten, 1=RQ_MSA_ENG_STA_2_Motor_nicht_starten, 0=RQ_MSA_ENG_STA_2_INIT
  compu method comRqMsaEngSta1_Semantic: 3=RQ_MSA_ENG_STA_1_Signal_ungueltig, 2=RQ_MSA_ENG_STA_1_Motor_starten, 1=RQ_MSA_ENG_STA_1_Motor_nicht_starten, 0=RQ_MSA_ENG_STA_1_INIT
  compu method comDispReasPrevSwoCeng_Semantic: 5=DISP_REAS_PREV_SWO_CENG_Signal_ungueltig, 8=DISP_REAS_PREV_SWO_CENG_VM_laeuft_systembedingt, 7=DISP_REAS_PREV_SWO_CENG_VM_laeuft_wegen_hoher_Temperatur, 6=DISP_REAS_PREV_SWO_CENG_VM_laeuft_wegen_geringer_Temperat, 5=DISP_REAS_PREV_SWO_CENG_VM_laeuft_wegen_hoher_Motortemper, 4=DISP_REAS_PREV_SWO_CENG_VM_laeuft_wegen_niedriger_Motorte, 3=DISP_REAS_PREV_SWO_CENG_VM_laeuft_wegen_Batterieladezusta, 2=DISP_REAS_PREV_SWO_CENG_VM_laeuft_wegen_Komfortanforderun, 1=DISP_REAS_PREV_SWO_CENG_Motorstart_wurde_durch_Fahrer_er, 0=DISP_REAS_PREV_SWO_CENG_Kein_Abschaltverhinderer
  compu method comAlivStEngStaAuto_Semantic: 5=ALIV_ST_ENG_STA_AUTO_Signal_ungueltig
  compu method comStCtHabr_Semantic: 3=ST_CT_HABR_Signal_ungueltig, 2=ST_CT_HABR_Handbremse_angezogen, 1=ST_CT_HABR_Handbremse_geloest, 0=ST_CT_HABR_nicht_codiert
  compu method comStKlVa_Semantic: 3=ST_KL_VA_Signal_ungueltig, 1=ST_KL_VA_EIN, 0=ST_KL_VA_AUS
  compu method comStEnergPwmg_Semantic: 5=ST_ENERG_PWMG_Signal_ungueltig, 8=ST_ENERG_PWMG_Batterieladezustand_100, 4=ST_ENERG_PWMG_Bordnetzzustand_gut, 2=ST_ENERG_PWMG_Keine_Standverbraucher_zulaessig, 1=ST_ENERG_PWMG_Abschalten_der_Kl_30_F
  compu method comSlctnSpcos_Semantic: 5=SLCTN_SPCOS_Signal_ungueltig, 1=SLCTN_SPCOS_PTC_Zuheizer, 0=SLCTN_SPCOS_Kein_Sonderverbraucher_ausgewaehl
  compu method comRqPcos_Semantic: 3=RQ_PCOS_Signal_ungueltig, 2=RQ_PCOS_unbelegt, 1=RQ_PCOS_Standverbraucher_muessen_sich_zu, 0=RQ_PCOS_Keine_Aktion
  compu method comCtrPwrSpcos_Semantic: 5=CTR_PWR_SPCOS_Signal_ungueltig
  compu method comCtrPwrCos_Semantic: 5=CTR_PWR_COS_ungueltig, 0=CTR_PWR_COS_Keine_Reduzierung
  compu method comCtrPcos_Semantic: 3=CTR_PCOS_Signal_ungueltig, 2=CTR_PCOS_Standverbraucher_muessen_sich_abs, 1=CTR_PCOS_Spezielle_Standverbraucher_duerfe, 0=CTR_PCOS_Keine_Aktion
  compu method comCtrCbr_Semantic: 5=CTR_CBR_Signal_ungueltig, 7=CTR_CBR_Alle_6_Stromzweige_EIN, 1=CTR_CBR_Alle_Stromzweige_AUS, 7=CTR_CBR_Stromzweige_1_und_2_EIN
  compu method comOtmpItli_Semantic: 3=OTMP_ITLI_Signal_ungueltig, 1=OTMP_ITLI_Uebertemperatur, 0=OTMP_ITLI_keine_Uebertemperatur
  compu method comOpPubuKrlStw_Semantic: 3=OP_PUBU_KRL_STW_Signal_ungueltig, 1=OP_PUBU_KRL_STW_Raendelrad_gedrueckt, 0=OP_PUBU_KRL_STW_Init_Keine_Betaetigung
  compu method comOpPubuLiRc_Semantic: 3=OP_PUBU_LI_RC_Signal_ungueltig, 1=OP_PUBU_LI_RC_Taster_gedrueckt, 0=OP_PUBU_LI_RC_Taster_nicht_gedrueckt
  compu method comOpPubuItli_Semantic: 3=OP_PUBU_ITLI_Signal_ungueltig, 1=OP_PUBU_ITLI_Taster_gedrueckt, 0=OP_PUBU_ITLI_Taster_nicht_gedrueckt
  compu method comStEcuOpCctr_Semantic: 5=ST_ECU_OP_CCTR_Signal_ungueltig, 4=ST_ECU_OP_CCTR_Zustand_Reserviert_14, 3=ST_ECU_OP_CCTR_Zustand_Reserviert_13, 2=ST_ECU_OP_CCTR_Zustand_Reserviert_12, 1=ST_ECU_OP_CCTR_Zustand_Reserviert_11, 0=ST_ECU_OP_CCTR_Zustand_Reset, 9=ST_ECU_OP_CCTR_Zustand_Nicht_verfuegbar, 8=ST_ECU_OP_CCTR_Zustand_PowerSave, 7=ST_ECU_OP_CCTR_Zustand_Powerdown, 6=ST_ECU_OP_CCTR_Zustand_Diagnose_Unterspannung_s, 5=ST_ECU_OP_CCTR_Zustand_Diagnose_Ueberspannung_se, 4=ST_ECU_OP_CCTR_Zustand_Diagnose, 3=ST_ECU_OP_CCTR_Zustand_Normalbetrieb_Unterspann, 2=ST_ECU_OP_CCTR_Zustand_Normalbetrieb_Ueberspannu, 1=ST_ECU_OP_CCTR_Zustand_Normalbetrieb, 0=ST_ECU_OP_CCTR_Zustand_Initialisierung
  compu method comQuSerOpCctr_Semantic: 5=QU_SER_OP_CCTR_Signal_ungueltig
  compu method comOpCctrOpel6_Semantic: 5=OP_CCTR_OPEL_6_Signal_ungueltig, 6=OP_CCTR_OPEL_6_Nicht_belegt, 1=OP_CCTR_OPEL_6_Stellung_aktiv, 0=OP_CCTR_OPEL_6_Neutralstellung
  compu method comOpCctrOpel5_Semantic: 5=OP_CCTR_OPEL_5_Signal_ungueltig, 6=OP_CCTR_OPEL_5_Nicht_belegt, 5=OP_CCTR_OPEL_5_Stellung_aktiv, 0=OP_CCTR_OPEL_5_Neutralstellung
  compu method comOpCctrOpel4_Semantic: 5=OP_CCTR_OPEL_4_Signal_ungueltig, 6=OP_CCTR_OPEL_4_Nicht_belegt, 1=OP_CCTR_OPEL_4_Stellung_aktiv, 0=OP_CCTR_OPEL_4_Neutralstellung
  compu method comOpCctrOpel3_Semantic: 5=OP_CCTR_OPEL_3_Signal_ungueltig, 6=OP_CCTR_OPEL_3_Stellung_aktiv_hinten, 4=OP_CCTR_OPEL_3_Nicht_belegt, 2=OP_CCTR_OPEL_3_Stellung_aktiv_vorne, 0=OP_CCTR_OPEL_3_Neutralstellung
  compu method comOpCctrOpel2_Semantic: 5=OP_CCTR_OPEL_2_Signal_ungueltig, 6=OP_CCTR_OPEL_2_Nicht_belegt, 1=OP_CCTR_OPEL_2_Stellung_aktiv, 0=OP_CCTR_OPEL_2_Neutralstellung
  compu method comOpCctrOpel1_Semantic: 5=OP_CCTR_OPEL_1_Signal_ungueltig, 6=OP_CCTR_OPEL_1_Nicht_belegt, 1=OP_CCTR_OPEL_1_Stellung_aktiv, 0=OP_CCTR_OPEL_1_Neutralstellung
  compu method comAlivOpCctr_Semantic: 5=ALIV_OP_CCTR_Signal_ungueltig
  compu method comStMemoFn_Semantic: 3=ST_MEMO_FN_Signal_ungueltig, 2=ST_MEMO_FN_Speichern, 1=ST_MEMO_FN_Abrufen, 0=ST_MEMO_FN_Keine_Aktion
  compu method comPoMemo_Semantic: 5=PO_MEMO_Signal_ungueltig, 4=PO_MEMO_Vorhalt_fuer_Speicherplatznummer, 2=PO_MEMO_Speicherplatznummer_fuer_nicht_sc, 2=PO_MEMO_Reserviert, 9=PO_MEMO_Speicherplatznummer_fuer_Benutzer, 0=PO_MEMO_Keine_gueltige_Speicherplatznumme
  compu method comDmpngLcdLum_Semantic: 5=DMPNG_LCD_LUM_Signal_ungueltig
  compu method comDayNiChov_Semantic: 3=DAY_NI_CHOV_Signal_ungueltig, 2=DAY_NI_CHOV_Nacht, 1=DAY_NI_CHOV_Tag, 0=DAY_NI_CHOV_keine_Aenderung
  compu method comStKlR_Semantic: 3=ST_KL_R_Signal_ungueltig, 2=ST_KL_R_Reserviert, 1=ST_KL_R_Klemme_R_EIN, 0=ST_KL_R_Klemme_R_AUS
  compu method comStKl50_Semantic: 3=ST_KL_50_Signal_ungueltig, 2=ST_KL_50_Anlassstart_Wunsch_Anlasser_noc, 1=ST_KL_50_Klemme_50_EIN, 0=ST_KL_50_Klemme_50_AUS
  compu method comStKl15_Semantic: 3=ST_KL_15_Signal_ungueltig, 2=ST_KL_15_Reserviert, 1=ST_KL_15_Klemme_15_EIN, 0=ST_KL_15_Klemme_15_AUS
  compu method comStKeyVld_Semantic: 3=ST_KEY_VLD_Signal_ungueltig, 2=ST_KEY_VLD_Ungueltiger_Schluessel_erkannt_bzw, 1=ST_KEY_VLD_Gueltiger_Schluessel_erkannt, 0=ST_KEY_VLD_Kein_Schluessel_erkannt
  compu method comStKeyPlgd_Semantic: 3=ST_KEY_PLGD_Signal_ungueltig, 2=ST_KEY_PLGD_Signal_unplausibel, 1=ST_KEY_PLGD_Schluessel_steckt_im_ZAS, 0=ST_KEY_PLGD_Kein_Schluessel_im_ZAS
  compu method comNoKey_Semantic: 5=NO_KEY_Signal_ungueltig, 4=NO_KEY_Kein_Schluessel, 3=NO_KEY_Ungueltige_Schluessel, 0=NO_KEY_Nachlaufschluessel
  compu method comStVehCon_Semantic: 5=ST_VEH_CON_Signal_ungueltig, 4=ST_VEH_CON_Error_VSM_STM_STATE_ERROR, 3=ST_VEH_CON_Car_wash_operation_VSM_STM_STAT, 2=ST_VEH_CON_Start_engine_vehicle_coasting, 1=ST_VEH_CON_Start_engine_VSM_STM_STATE_ENG, 0=ST_VEH_CON_Impending_start_of_engine_vehic, 9=ST_VEH_CON_Impending_start_of_engine_VSM_S, 8=ST_VEH_CON_Driving_VSM_STM_STATE_DRIVE, 7=ST_VEH_CON_Ignition_On_vehicle_not_coastin, 6=ST_VEH_CON_Ignition_On_vehicle_coasting_V, 5=ST_VEH_CON_Ignition_On_VSM_STM_STATE_IGNIT, 4=ST_VEH_CON_Engine_postrun_VSM_STM_STATE_15, 3=ST_VEH_CON_Basis_operation_vehicle_coastin, 2=ST_VEH_CON_Basis_operation_driver_present, 1=ST_VEH_CON_Standby_driver_absent_VSM_STM, 0=ST_VEH_CON_Initial_VSM_STM_STATE_INIT
  compu method comStStcdPeng_Semantic: 3=ST_STCD_PENG_Signal_ungueltig, 2=ST_STCD_PENG_Startbedingung_Kraftschluss_unpl, 1=ST_STCD_PENG_Startbedingung_Kraftschluss_erfue, 0=ST_STCD_PENG_Startbedingung_Kraftschluss_nich
  compu method comStSsp_Semantic: 3=ST_SSP_Signal_ungueltig, 2=ST_SSP_zwei_Taster_Hallsensor_erkannt, 1=ST_SSP_ein_Taster_Hallsensor_erkannt, 0=ST_SSP_kein_Taster_Hallsensor_erkannt
  compu method comStOpMsa_Semantic: 3=ST_OP_MSA_Signal_ungueltig, 2=ST_OP_MSA_MSA_Status_unplausibel, 1=ST_OP_MSA_MSA_deaktiv, 0=ST_OP_MSA_MSA_aktiv
  compu method comStKlDiv_Semantic: 5=ST_KL_DIV_KL_DIV_INVALID, 4=ST_KL_DIV_KL_DIV_FAILURE, 3=ST_KL_DIV_KL_DIV_TIMEOUT, 2=ST_KL_DIV_KL_DIV_INVALID_CP, 1=ST_KL_DIV_KL_DIV_TIMEOUT_CP, 0=ST_KL_DIV_KL_DIV_FAILURE_CP, 9=ST_KL_DIV_KL_DIV_BLOCKED, 8=ST_KL_DIV_KL_DIV_VALID_IDLE, 7=ST_KL_DIV_KL_DIV_RELEASE_TRIG, 6=ST_KL_DIV_KL_DIV_WAIT_VALID, 5=ST_KL_DIV_KL_DIV_WAIT_NVM, 4=ST_KL_DIV_KL_DIV_SAVED, 3=ST_KL_DIV_KL_DIV_RELEASED, 2=ST_KL_DIV_KL_DIV_REQUEST, 1=ST_KL_DIV_KL_DIV_IDLE, 0=ST_KL_DIV_KL_DIV_INIT
  compu method comStKlDbg_Semantic: 5=ST_KL_DBG_Signal_ungueltig
  compu method comStKl50Msa_Semantic: 3=ST_KL_50_MSA_Signal_ungueltig, 2=ST_KL_50_MSA_Reserve, 1=ST_KL_50_MSA_KL_50_MSA_ein, 0=ST_KL_50_MSA_KL_50_MSA_aus
  compu method comStKl30b_Semantic: 5=ST_KL_30B_Signal_ungueltig, 4=ST_KL_30B_Fehler, 3=ST_KL_30B_KL30B_Dauer_Ein, 2=ST_KL_30B_Nachlauf_groesser_10min_und_kleine, 1=ST_KL_30B_Nachlauf_groesser_5min_und_kleiner, 0=ST_KL_30B_Nachlauf_groesser_1min_und_kleiner, 9=ST_KL_30B_Nachlauf_groesser_50s_und_kleinerg, 8=ST_KL_30B_Nachlauf_groesser_40s_und_kleinerg, 7=ST_KL_30B_Nachlauf_groesser_30s_und_kleinerg, 6=ST_KL_30B_Nachlauf_groesser_20s_und_kleinerg, 5=ST_KL_30B_Nachlauf_groesser_10s_und_kleinerg, 4=ST_KL_30B_Nachlauf_groesser_5s_und_kleinergl, 3=ST_KL_30B_Nachlauf_groesser_1s_und_kleinergl, 2=ST_KL_30B_Nachlauf_groesser_0s_und_kleinergl, 1=ST_KL_30B_KL30BAus, 0=ST_KL_30B_Init_Wert
  compu method comStKl15n_Semantic: 5=ST_KL_15N_Signal_ungueltig, 4=ST_KL_15N_Fehler, 3=ST_KL_15N_KL15N_Dauer_Ein, 2=ST_KL_15N_Nachlauf_Fahrt_Motorlauf, 1=ST_KL_15N_Nachlauf_kleiner_1_min, 0=ST_KL_15N_Reserviert, 6=ST_KL_15N_Nachlauf_groesser_4000ms_undkleine, 5=ST_KL_15N_Nachlauf_groesser_3000ms_und_klein, 4=ST_KL_15N_Nachlauf_groesser_2000ms_und_klein, 3=ST_KL_15N_Nachlauf_groesser_1000ms_und_klein, 2=ST_KL_15N_Nachlauf_groesser_0s_und_kleinerg, 1=ST_KL_15N_KL15N_Aus, 0=ST_KL_15N_Init_Wert
  compu method comRwdtBls_Semantic: 5=RWDT_BLS_Signal_ungueltig, 8=RWDT_BLS_Initialisierung, 7=RWDT_BLS_Mehrfachfehler, 6=RWDT_BLS_Fehler_Bremslichtsignal, 5=RWDT_BLS_Fehler_Bremslichttestsignal, 4=RWDT_BLS_Einfachfehler, 3=RWDT_BLS_Bremslichtsignal_und_Bremslicht, 2=RWDT_BLS_Nur_Bremslichttestsignal_betaetig, 1=RWDT_BLS_Nur_Bremslichtsignal_betaetigt, 0=RWDT_BLS_Bremslichtsignal_und_Bremslichtt
  compu method comCtrEngStop_Semantic: 3=CTR_ENG_STOP_Signal_ungueltig, 2=CTR_ENG_STOP_Motor_aus, 1=CTR_ENG_STOP_Default, 0=CTR_ENG_STOP_Init
  compu method comStFllvFutaSpar_Semantic: 3=ST_FLLV_FUTA_SPAR_Signal_ungueltig, 1=ST_FLLV_FUTA_SPAR_Aktiv, 0=ST_FLLV_FUTA_SPAR_Nicht_Aktiv
  compu method comTypDscoKl30Erctr_Semantic: 3=TYP_DSCO_KL_30_ERCTR_Signal_ungueltig, 2=TYP_DSCO_KL_30_ERCTR_Dauerhafte_Abschaltung, 1=TYP_DSCO_KL_30_ERCTR_Reset, 0=TYP_DSCO_KL_30_ERCTR_Keine_Abschaltung
  compu method comFlluptKl30Erctr_Semantic: 5=FLLUPT_KL_30_ERCTR_Signal_ungueltig, 4=FLLUPT_KL_30_ERCTR_Dauer_EIN
  compu method comFlluptGpwsup_Semantic: 5=FLLUPT_GPWSUP_Signal_ungueltig, 4=FLLUPT_GPWSUP_Dauer_EIN
  compu method comIDrawVibStwLin_Semantic: 255=I_DRAW_VIB_STW_LIN_Signal_ungueltig
  compu method comAvlUVibStwLin_Semantic: 255=AVL_U_VIB_STW_LIN_Signal_ungueltig
  compu method comErrStPwsupVibStwLin_Semantic: 0=ERR_ST_PWSUP_VIB_STW_LIN_Kein_Fehler, 1=ERR_ST_PWSUP_VIB_STW_LIN_Leistungselektonik_n_i_O, 2=ERR_ST_PWSUP_VIB_STW_LIN_Aktuator_nicht_Angeschlossen, 3=ERR_ST_PWSUP_VIB_STW_LIN_Akuator_Kurzgeschlossen, 7=ERR_ST_PWSUP_VIB_STW_LIN_Signal_ungueltig
  compu method comErrStOtmpVibStwLin_Semantic: 0=ERR_ST_OTMP_VIB_STW_LIN_keine_Uebertemperatur, 1=ERR_ST_OTMP_VIB_STW_LIN_Uebertemperatur, 3=ERR_ST_OTMP_VIB_STW_LIN_Signal_ungueltig
  compu method comErrStOcuVibStwLin_Semantic: 0=ERR_ST_OCU_VIB_STW_LIN_kein_Ueberstrom, 1=ERR_ST_OCU_VIB_STW_LIN_Ueberstrom, 3=ERR_ST_OCU_VIB_STW_LIN_Signal_ungueltig
  compu method comErrStUVibStwLin_Semantic: 0=ERR_ST_U_VIB_STW_LIN_Versorungsspannung_in_ordnung, 1=ERR_ST_U_VIB_STW_LIN_Versorungsspannung_fehlerhaft, 3=ERR_ST_U_VIB_STW_LIN_Signal_ungueltig
  compu method comErrStBlkVibStwLin_Semantic: 0=ERR_ST_BLK_VIB_STW_LIN_Kein_Fehler, 1=ERR_ST_BLK_VIB_STW_LIN_Akuator_blockiert, 3=ERR_ST_BLK_VIB_STW_LIN_Signal_ungueltig
  compu method comErrStIntlLreLin_Semantic: 0=ERR_ST_INTL_LRE_LIN_kein_Fehler, 1=ERR_ST_INTL_LRE_LIN_Fehler_aktiv, 3=ERR_ST_INTL_LRE_LIN_Signal_ungueltig
  compu method comErrStScStwhLin_Semantic: 0=ERR_ST_SC_STWH_LIN_kein_Fehler, 1=ERR_ST_SC_STWH_LIN_Fehler_aktiv, 3=ERR_ST_SC_STWH_LIN_Signal_ungueltig
  compu method comErrStCtNtcStwhLin_Semantic: 0=ERR_ST_CT_NTC_STWH_LIN_kein_Fehler, 1=ERR_ST_CT_NTC_STWH_LIN_Fehler_aktiv, 3=ERR_ST_CT_NTC_STWH_LIN_Signal_ungueltig
  compu method comErrStUuStwhLin_Semantic: 0=ERR_ST_UU_STWH_LIN_kein_Fehler, 1=ERR_ST_UU_STWH_LIN_Fehler_aktiv, 3=ERR_ST_UU_STWH_LIN_Signal_ungueltig
  compu method comErrStOvlStwhLin_Semantic: 0=ERR_ST_OVL_STWH_LIN_kein_Fehler, 1=ERR_ST_OVL_STWH_LIN_Fehler_aktiv, 3=ERR_ST_OVL_STWH_LIN_Signal_ungueltig
  compu method comErrStLdStwhLin_Semantic: 0=ERR_ST_LD_STWH_LIN_kein_Fehler, 1=ERR_ST_LD_STWH_LIN_Fehler_aktiv, 3=ERR_ST_LD_STWH_LIN_Signal_ungueltig
  compu method comIDrawStwhLin_Semantic: 255=I_DRAW_STWH_LIN_Signal_ungueltig
  compu method comStSwCltDrv_Semantic: 3=ST_SW_CLT_DRV_Signal_ungueltig_Kupplung_nicht, 1=ST_SW_CLT_DRV_Kupplung_betaetigt, 0=ST_SW_CLT_DRV_Kupplung_nicht_betaetigt
  compu method comStIlkStrtDrv_Semantic: 3=ST_ILK_STRT_DRV_Signal_ungueltig, 2=ST_ILK_STRT_DRV_Motorstart_zulassen_Motorstop_z, 1=ST_ILK_STRT_DRV_Motorstart_zulassen_Getriebe_i, 0=ST_ILK_STRT_DRV_Kein_Motorstart
  compu method comStIdlgEngDrv_Semantic: 3=ST_IDLG_ENG_DRV_Signal_ungueltig, 1=ST_IDLG_ENG_DRV_Motor_nicht_im_Leerlauf, 0=ST_IDLG_ENG_DRV_Leerlauf
  compu method comStGrselDrv_Semantic: 5=ST_GRSEL_DRV_Signal_ungueltig, 3=ST_GRSEL_DRV_9, 2=ST_GRSEL_DRV_8, 1=ST_GRSEL_DRV_7, 0=ST_GRSEL_DRV_6, 9=ST_GRSEL_DRV_5, 8=ST_GRSEL_DRV_4, 7=ST_GRSEL_DRV_3, 6=ST_GRSEL_DRV_2, 5=ST_GRSEL_DRV_1, 3=ST_GRSEL_DRV_P, 2=ST_GRSEL_DRV_R, 1=ST_GRSEL_DRV_N, 4=ST_GRSEL_DRV_Reserve
  compu method comStEngRunDrv_Semantic: 3=ST_ENG_RUN_DRV_Signal_ungueltig, 2=ST_ENG_RUN_DRV_Motor_laeuft, 1=ST_ENG_RUN_DRV_Motor_startet, 0=ST_ENG_RUN_DRV_Motor_aus
  compu method comStEcuDtPt2_Semantic: 5=ST_ECU_DT_PT_2_Signal_ungueltig, 4=ST_ECU_DT_PT_2_Zustand_Reserviert_14, 3=ST_ECU_DT_PT_2_Zustand_Reserviert_13, 2=ST_ECU_DT_PT_2_Zustand_Reserviert_12, 1=ST_ECU_DT_PT_2_Zustand_Reserviert_11, 0=ST_ECU_DT_PT_2_Zustand_Reset, 9=ST_ECU_DT_PT_2_Zustand_Nicht_verfuegbar, 8=ST_ECU_DT_PT_2_Zustand_PowerSave, 7=ST_ECU_DT_PT_2_Zustand_Powerdown, 6=ST_ECU_DT_PT_2_Zustand_Diagnose_Unterspannung_s, 5=ST_ECU_DT_PT_2_Zustand_Diagnose_Ueberspannung_se, 4=ST_ECU_DT_PT_2_Zustand_Diagnose, 3=ST_ECU_DT_PT_2_Zustand_Normalbetrieb_Unterspann, 2=ST_ECU_DT_PT_2_Zustand_Normalbetrieb_Ueberspannu, 1=ST_ECU_DT_PT_2_Zustand_Normalbetrieb, 0=ST_ECU_DT_PT_2_Zustand_Initialisierung
  compu method comRlsEngsta_Semantic: 3=RLS_ENGSTA_Signal_ungueltig, 2=RLS_ENGSTA_Motorstart_zulassen, 1=RLS_ENGSTA_Motorstart_stop_verzoegert, 0=RLS_ENGSTA_Kein_Motorstart
  compu method comRducDoctrRpmDrv2_Semantic: 3=RDUC_DOCTR_RPM_DRV_2_Signal_ungueltig, 2=RDUC_DOCTR_RPM_DRV_2_grosse_Reduzierung_der_Abregeldre, 1=RDUC_DOCTR_RPM_DRV_2_kleine_Reduzierung_der_Abregeldr, 0=RDUC_DOCTR_RPM_DRV_2_in_Ordnung
  compu method comAlivDtPt2_Semantic: 5=ALIV_DT_PT_2_Signal_ungueltig
  compu method comPwmIlumSwLin_Semantic: 255=PWM_ILUM_SW_LIN_Signal_ungueltig
  compu method comPwmFnIlumLin_Semantic: 255=PWM_FN_ILUM_LIN_Signal_ungueltig
  compu method comCtrIlumSw_Semantic: 5=CTR_ILUM_SW_Signal_ungueltig, 4=CTR_ILUM_SW_Tag
  compu method comStHotmPeri_Semantic: 3=ST_HOTM_PERI_Signal_ungueltig, 1=ST_HOTM_PERI_Hotelstellung_aktiv, 0=ST_HOTM_PERI_Hotelstellung_nicht_aktiv
  compu method comStClsyUnitRplk_Semantic: 3=ST_CLSY_UNIT_RPLK_Signal_ungueltig, 1=ST_CLSY_UNIT_RPLK_Mindestens_1_Aggregat, 0=ST_CLSY_UNIT_RPLK_Kein_Aggregat
  compu method comStClsySafInhi_Semantic: 3=ST_CLSY_SAF_INHI_Signal_ungueltig, 1=ST_CLSY_SAF_INHI_Sichern_gesperrt, 0=ST_CLSY_SAF_INHI_Sichern_erlaubt
  compu method comOpPubuBtlFtwlDr_Semantic: 3=OP_PUBU_BTL_FTWL_DR_Signal_ungueltig, 1=OP_PUBU_BTL_FTWL_DR_Taster_wurde_betaetigt, 0=OP_PUBU_BTL_FTWL_DR_Keine_Aktion
  compu method comCtrClsyPsdr_Semantic: 5=CTR_CLSY_PSDR_Signal_ungueltig, 8=CTR_CLSY_PSDR_Keine_Aenderung
  compu method comCtrClsyPsd_Semantic: 5=CTR_CLSY_PSD_Signal_ungueltig, 8=CTR_CLSY_PSD_Keine_Aenderung
  compu method comCtrClsyFuff_Semantic: 5=CTR_CLSY_FUFF_Signal_ungueltig, 8=CTR_CLSY_FUFF_Keine_Aenderung
  compu method comCtrClsyDvdr_Semantic: 5=CTR_CLSY_DVDR_Signal_ungueltig, 8=CTR_CLSY_DVDR_Keine_Aenderung
  compu method comCtrClsyDrd_Semantic: 5=CTR_CLSY_DRD_Signal_ungueltig, 8=CTR_CLSY_DRD_Keine_Aenderung
  compu method comCtrClsyBtl_Semantic: 5=CTR_CLSY_BTL_Signal_ungueltig, 8=CTR_CLSY_BTL_Keine_Aenderung
  compu method comCtrFnWell_Semantic: 15=CTR_FN_WELL_Signal_ung_ltig, 6=CTR_FN_WELL_WELL_MODE_4, 5=CTR_FN_WELL_WELL_MODE_3, 4=CTR_FN_WELL_WELL_MODE_2, 3=CTR_FN_WELL_WELL_MODE_1, 2=CTR_FN_WELL_OFF_WELL_HARD, 1=CTR_FN_WELL_OFF_WELL, 0=CTR_FN_WELL_INIT
  compu method comCtrFnRvlp_Semantic: 15=CTR_FN_RVLP_Signal_ung_ltig, 3=CTR_FN_RVLP_ON_TRM, 2=CTR_FN_RVLP_ON, 1=CTR_FN_RVLP_OFF, 0=CTR_FN_RVLP_INIT
  compu method comCtrFnRflp_Semantic: 15=CTR_FN_RFLP_Signal_ung_ltig, 9=CTR_FN_RFLP_ON_RFLI_ASYNC, 8=CTR_FN_RFLP_ON_RFLI_SYNC, 4=CTR_FN_RFLP_OFF_RFLI_ON_TRM, 3=CTR_FN_RFLP_ON_RFLI_ON_TRM, 2=CTR_FN_RFLP_ON_RFLI_OFF_TRM, 1=CTR_FN_RFLP_OFF_RFLI_OFF_TRM, 0=CTR_FN_RFLP_INIT
  compu method comCtrFnPoli_Semantic: 15=CTR_FN_POLI_Signal_ung_ltig, 4=CTR_FN_POLI_POLI_MODUS3, 3=CTR_FN_POLI_POLI_MODUS2, 2=CTR_FN_POLI_POLI_MODUS1, 1=CTR_FN_POLI_OFF_POLI, 0=CTR_FN_POLI_INIT
  compu method comCtrFnPli_Semantic: 15=CTR_FN_PLI_Signal_ung_ltig, 3=CTR_FN_PLI_ON_RPLI_R, 2=CTR_FN_PLI_ON_RPLI_L, 1=CTR_FN_PLI_OFF_RPLI, 0=CTR_FN_PLI_INIT
  compu method comCtrFnFmh_Semantic: 3=CTR_FN_FMH_Signal_ung_ltig, 2=CTR_FN_FMH_ON_FMH, 1=CTR_FN_FMH_OFF_FMH, 0=CTR_FN_FMH_INIT
  compu method comCtrFnDrl_Semantic: 15=CTR_FN_DRL_Signal_ung_ltig, 14=CTR_FN_DRL_DRL_INTERM_MODE_2, 13=CTR_FN_DRL_DRL_INTERM_MODE_1, 10=CTR_FN_DRL_DRL_ASYNC_MODE_2, 9=CTR_FN_DRL_DRL_ASYNC_MODE_1, 6=CTR_FN_DRL_DRL_SYNC_MODE_2, 5=CTR_FN_DRL_DRL_SYNC_MODE_1, 2=CTR_FN_DRL_ON_DRL, 1=CTR_FN_DRL_OFF_DRL, 0=CTR_FN_DRL_INIT
  compu method comCtrFnBl_Semantic: 3=CTR_FN_BL_Signal_ung_ltig, 2=CTR_FN_BL_ON_BL, 1=CTR_FN_BL_OFF_BL, 0=CTR_FN_BL_INIT
  compu method comCtrFnBfd_Semantic: 15=CTR_FN_BFD_Signal_ung_ltig, 5=CTR_FN_BFD_BFD_MODE_4, 4=CTR_FN_BFD_BFD_MODE_3, 3=CTR_FN_BFD_BFD_MODE_2, 2=CTR_FN_BFD_BFD_MODE_1, 1=CTR_FN_BFD_OFF_BFD, 0=CTR_FN_BFD_INIT
  compu method comAlivCtrLpEx_Semantic: 15=ALIV_CTR_LP_EX_Signal_ung_ltig
  compu method comCtrItliRc_Semantic: 3=CTR_ITLI_RC_Signal_ungueltig, 1=CTR_ITLI_RC_Einschalten, 0=CTR_ITLI_RC_Ausschalten
  compu method comCtrItliFrt_Semantic: 3=CTR_ITLI_FRT_Signal_ungueltig, 1=CTR_ITLI_FRT_Einschalten, 0=CTR_ITLI_FRT_Ausschalten
  compu method comCtrItli_Semantic: 3=CTR_ITLI_Signal_ungueltig, 1=CTR_ITLI_Einschalten, 0=CTR_ITLI_Ausschalten
  compu method comCtrDimItli_Semantic: 3=CTR_DIM_ITLI_Signal_ungueltig, 1=CTR_DIM_ITLI_Gedimmter_Uebergang, 0=CTR_DIM_ITLI_Harter_Uebergang
  compu method comStRmstAl_Semantic: 3=ST_RMST_AL_Signal_ungueltig, 0=ST_RMST_AL_Keine_Anforderung
  compu method comStRmcBt_Semantic: 3=ST_RMC_BT_Signal_ungueltig, 1=ST_RMC_BT_Unterspannung_liegt_vor, 0=ST_RMC_BT_Batterie_in_Ordnung
  compu method comCtrSirRmstSfy_Semantic: 3=CTR_SIR_RMST_SFY_Signal_ungueltig, 2=CTR_SIR_RMST_SFY_Sirene_EIN, 1=CTR_SIR_RMST_SFY_Sirene_AUS, 0=CTR_SIR_RMST_SFY_Keine_Aktion
  compu method comCtrIdcRmstSfy_Semantic: 3=CTR_IDC_RMST_SFY_Signal_ungueltig, 2=CTR_IDC_RMST_SFY_Fernstart_Warnblinken_EIN, 1=CTR_IDC_RMST_SFY_Fernstart_Warnblinken_AUS, 0=CTR_IDC_RMST_SFY_Keine_Aktion
  compu method comCtrEngRmstSfy_Semantic: 3=CTR_ENG_RMST_SFY_Signal_ungueltig, 2=CTR_ENG_RMST_SFY_Motor_EIN, 1=CTR_ENG_RMST_SFY_Motor_AUS, 0=CTR_ENG_RMST_SFY_Keine_Aktion
  compu method comCtrLed2Cabrf_Semantic: 3=CTR_LED_2_CABRF_Signal_ungueltig, 2=CTR_LED_2_CABRF_LED_2_Blinken, 1=CTR_LED_2_CABRF_LED_2_Dauerleuchten, 0=CTR_LED_2_CABRF_LED_2_Aus
  compu method comCtrLed1Cabrf_Semantic: 3=CTR_LED_1_CABRF_Signal_ungueltig, 2=CTR_LED_1_CABRF_LED_1_Blinken, 1=CTR_LED_1_CABRF_LED_1_Dauerleuchten, 0=CTR_LED_1_CABRF_LED_1_Aus
  compu method comStExceThrvAcln_Semantic: 3=ST_EXCE_THRV_ACLN_Signal_ungueltig, 1=ST_EXCE_THRV_ACLN_Beschleunigungsschwelle_ueberschr, 0=ST_EXCE_THRV_ACLN_Beschleunigungsschwelle_nicht_ueb
  compu method comStCrse_Semantic: 5=ST_CRSE_Signal_ungueltig, 0=ST_CRSE_Kein_Crash
  compu method comQuanTrgSqbs_Semantic: 0=QUAN_TRG_SQBS_keine_Zuendpille_ausgeloest
  compu method comCtrCrPhtr_Semantic: 3=CTR_CR_PHTR_Signal_ungueltig, 2=CTR_CR_PHTR_Standheizung_ausschalten, 1=CTR_CR_PHTR_Standheizung_nicht_ausschalten
  compu method comCtrCrItli_Semantic: 3=CTR_CR_ITLI_Signal_ungueltig, 2=CTR_CR_ITLI_Innenbeleuchtung_einschalten, 1=CTR_CR_ITLI_Innenbeleuchtung_nicht_einschalt
  compu method comCtrCrHazw_Semantic: 3=CTR_CR_HAZW_Signal_ungueltig, 2=CTR_CR_HAZW_Warnblinker_einschalten, 1=CTR_CR_HAZW_Warnblinker_nicht_einschalten
  compu method comCtrCrClsy_Semantic: 3=CTR_CR_CLSY_Signal_ungueltig, 2=CTR_CR_CLSY_Zentralverriegelung_oeffnen, 1=CTR_CR_CLSY_Zentralverriegelung_nicht_oeffnen
  compu method comCtrCrAutomEcal_Semantic: 3=CTR_CR_AUTOM_ECAL_Signal_ungueltig, 2=CTR_CR_AUTOM_ECAL_Automatischen_Notruf_ausloesen, 1=CTR_CR_AUTOM_ECAL_Keinen_automatischen_Notruf_ausl, 0=CTR_CR_AUTOM_ECAL_Reserviert
  compu method comSuZvSlcvFbCkm_Semantic: 3=SU_ZV_SLCV_FB_CKM_Signal_ungueltig, 2=SU_ZV_SLCV_FB_CKM_1_mal_Druecken_Fahrertuer_offen, 1=SU_ZV_SLCV_FB_CKM_1_mal_Druecken_alles_offen, 0=SU_ZV_SLCV_FB_CKM_Keine_Angabe
  compu method comSuZvLokAutoVCkm_Semantic: 3=SU_ZV_LOK_AUTO_V_CKM_Signal_ungueltig, 2=SU_ZV_LOK_AUTO_V_CKM_Aktiv, 1=SU_ZV_LOK_AUTO_V_CKM_Nicht_aktiv, 0=SU_ZV_LOK_AUTO_V_CKM_Keine_Angabe
  compu method comSuZvLokAutoTFbCkm_Semantic: 3=SU_ZV_LOK_AUTO_T_FB_CKM_Signal_ungueltig, 2=SU_ZV_LOK_AUTO_T_FB_CKM_Aktiv, 1=SU_ZV_LOK_AUTO_T_FB_CKM_Nicht_aktiv, 0=SU_ZV_LOK_AUTO_T_FB_CKM_Keine_Angabe
  compu method comSuZvHlpGtinCkm_Semantic: 3=SU_ZV_HLP_GTIN_CKM_Signal_ungueltig, 2=SU_ZV_HLP_GTIN_CKM_Aktiv, 1=SU_ZV_HLP_GTIN_CKM_Nicht_aktiv, 0=SU_ZV_HLP_GTIN_CKM_Keine_Angabe
  compu method comBrcOpWiswLin_Semantic: 0=BRC_OP_WISW_LIN_Keine_Aktion, 255=BRC_OP_WISW_LIN_Signal_ungueltig
  compu method comStPoFldtCabLin_Semantic: 0=ST_PO_FLDT_CAB_LIN_Cabrio_Verdeck_geschlossen, 1=ST_PO_FLDT_CAB_LIN_Cabrio_Verdeck_in_Zwischenstellung, 2=ST_PO_FLDT_CAB_LIN_Cabrio_Verdeck_abgelegt, 3=ST_PO_FLDT_CAB_LIN_Beladeposition_erreicht, 4=ST_PO_FLDT_CAB_LIN_Hardtop_aufgesetzt, 7=ST_PO_FLDT_CAB_LIN_Signal_ungueltig
  compu method comBrcPoWiblLin_Semantic: 0=BRC_PO_WIBL_LIN_Position_nicht_definiert, 1=BRC_PO_WIBL_LIN_Aufwaertshub_kurz_vor_Regensensor, 2=BRC_PO_WIBL_LIN_Abwaertshub_kurz_vor_Regensensor, 4=BRC_PO_WIBL_LIN_Aufwaertshub_kurz_vor_Umkehrlage_unten, 12=BRC_PO_WIBL_LIN_Obere_Wendelage_aktiv, 13=BRC_PO_WIBL_LIN_Rauslaufen_aus_dem_Rueckstellkontakt, 14=BRC_PO_WIBL_LIN_Reinlaufen_in_den_Rueckstellkontakt, 15=BRC_PO_WIBL_LIN_Signal_ungueltig
  compu method comBrcStKlLin_Semantic: 0=BRC_ST_KL_LIN_Init, 1=BRC_ST_KL_LIN_Reserve, 2=BRC_ST_KL_LIN_KL30, 3=BRC_ST_KL_LIN_KL30F_Aenderung, 4=BRC_ST_KL_LIN_KL30F_Ein, 5=BRC_ST_KL_LIN_KL30B_Aenderung, 6=BRC_ST_KL_LIN_KL30B_Ein, 7=BRC_ST_KL_LIN_KLR_Aenderung, 8=BRC_ST_KL_LIN_KLR_Ein, 9=BRC_ST_KL_LIN_KL15_Aenderung, 10=BRC_ST_KL_LIN_KL15_Ein, 11=BRC_ST_KL_LIN_KL50_Verzoegerung, 12=BRC_ST_KL_LIN_KL50_Aenderung, 13=BRC_ST_KL_LIN_KL50_Ein, 14=BRC_ST_KL_LIN_Fehler, 15=BRC_ST_KL_LIN_Signal_ungueltig
  compu method comBrcStHudLin_Semantic: 1=BRC_ST_HUD_LIN_aus, 2=BRC_ST_HUD_LIN_ein, 3=BRC_ST_HUD_LIN_Signal_ungueltig
  compu method comBrcTempExLin_Semantic: 255=BRC_TEMP_EX_LIN_Signal_ungueltig
  compu method comBrcVVehCogLin_Semantic: 4095=BRC_V_VEH_COG_LIN_Signal_ungueltig
  compu method comBrcOpWipoLin_Semantic: 0=BRC_OP_WIPO_LIN_Stufe_1, 1=BRC_OP_WIPO_LIN_Stufe_2, 2=BRC_OP_WIPO_LIN_Stufe_3, 4=BRC_OP_WIPO_LIN_Stufe_4, 7=BRC_OP_WIPO_LIN_Signal_ungueltig
  compu method comBrcCtrItliLin_Semantic: 0=BRC_CTR_ITLI_LIN_Ausschalten, 1=BRC_CTR_ITLI_LIN_Einschlten, 3=BRC_CTR_ITLI_LIN_Signal_ungueltig
  compu method comBrcStGrGrbLin_Semantic: 0=BRC_ST_GR_GRB_LIN_kein_Rueckwaertsgang, 1=BRC_ST_GR_GRB_LIN_R, 3=BRC_ST_GR_GRB_LIN_Signal_ungueltig
  compu method comPwmIlumSwLinIsp_Semantic: 255=PWM_ILUM_SW_LIN_ISP_Signal_ungueltig
  compu method comStIdcStop_Semantic: 3=ST_IDC_STOP_Signal_ung_ltig, 2=ST_IDC_STOP_Neuen_Blinktakt_starten, 1=ST_IDC_STOP_Synchronisation, 0=ST_IDC_STOP_Blinktakt_l_uft_weiter
  compu method comStIdcKi_Semantic: 3=ST_IDC_KI_Signal_ung_ltig, 1=ST_IDC_KI_Blinkerkontroll_Lampen_im_Kombi
  compu method comStIdc_Semantic: 7=ST_IDC_Signal_ung_ltig, 3=ST_IDC_Beide_Blinker_EIN, 2=ST_IDC_Blinker_rechts_EIN, 1=ST_IDC_Blinker_links_EIN, 0=ST_IDC_Beide_Blinker_AUS
  compu method comCclkIdc_Semantic: 15=CCLK_IDC_Signal_ung_ltig, 3=CCLK_IDC_Doppel_Blink_Impuls, 2=CCLK_IDC_Defekt_Blinktakt, 1=CCLK_IDC_Normal_Blinktakt, 0=CCLK_IDC_Nicht_blinken
  compu method comOpWisw_Semantic: 5=OP_WISW_Signal_ungueltig, 0=OP_WISW_Keine_Aktion
  compu method comOpWipo_Semantic: 7=OP_WIPO_Signal_ungueltig, 4=OP_WIPO_Stufe_4, 2=OP_WIPO_Stufe_3, 1=OP_WIPO_Stufe_2, 0=OP_WIPO_Stufe_1
  compu method comAlivWisw_Semantic: 5=ALIV_WISW_Signal_ungueltig
  compu method comStPubuMabAsst_Semantic: 3=ST_PUBU_MAB_ASST_Signal_ungueltig, 1=ST_PUBU_MAB_ASST_Taster_gedrueckt, 0=ST_PUBU_MAB_ASST_Keine_Betaetigung
  compu method comOpCols_Semantic: 5=OP_COLS_Signal_ungueltig, 0=OP_COLS_Keine_Aktion
  compu method comOpPubuTelStw_Semantic: 3=OP_PUBU_TEL_STW_Signal_ungueltig, 2=OP_PUBU_TEL_STW_Reserviert, 1=OP_PUBU_TEL_STW_Taster_TEL_gedrueckt, 0=OP_PUBU_TEL_STW_Keine_Aktion
  compu method comOpPubuSpfn2_Semantic: 3=OP_PUBU_SPFN_2_Signal_ungueltig, 1=OP_PUBU_SPFN_2_Taster_gedrueckt, 0=OP_PUBU_SPFN_2_Keine_Aktion
  compu method comOpPubuSpfn_Semantic: 3=OP_PUBU_SPFN_Signal_ungueltig, 1=OP_PUBU_SPFN_Taster_gedrueckt, 0=OP_PUBU_SPFN_Keine_Aktion
  compu method comOpPubuPttStw_Semantic: 3=OP_PUBU_PTT_STW_Signal_ungueltig, 1=OP_PUBU_PTT_STW_PTT_Taster_gedrueckt, 0=OP_PUBU_PTT_STW_Keine_Aktion
  compu method comOpPubuHorn_Semantic: 3=OP_PUBU_HORN_Signal_ungueltig, 1=OP_PUBU_HORN_HORN_Taster_gedrueckt, 0=OP_PUBU_HORN_Keine_Aktion
  compu method comOpPubuAudAvolStw_Semantic: 3=OP_PUBU_AUD_AVOL_STW_Signal_ungueltig, 2=OP_PUBU_AUD_AVOL_STW_Lautstaerke_lauter, 1=OP_PUBU_AUD_AVOL_STW_Lautstaerke_leiser, 0=OP_PUBU_AUD_AVOL_STW_Keine_Aktion_Keine_Betaetigung
  compu method comOpPubuAudAutuStw_Semantic: 3=OP_PUBU_AUD_AUTU_STW_Signal_ungueltig, 2=OP_PUBU_AUD_AUTU_STW_Suchlauf_aufwaerts, 1=OP_PUBU_AUD_AUTU_STW_Suchlauf_abwaerts, 0=OP_PUBU_AUD_AUTU_STW_Keine_Aktion
  compu method comStEcuAclnxCog_Semantic: 5=ST_ECU_ACLNX_COG_Signal_ungueltig, 4=ST_ECU_ACLNX_COG_Zustand_Reserviert_14, 3=ST_ECU_ACLNX_COG_Zustand_Reserviert_13, 2=ST_ECU_ACLNX_COG_Zustand_Reserviert_12, 1=ST_ECU_ACLNX_COG_Zustand_Reserviert_11, 0=ST_ECU_ACLNX_COG_Zustand_Reset, 9=ST_ECU_ACLNX_COG_Zustand_Nicht_verfuegbar, 8=ST_ECU_ACLNX_COG_Zustand_PowerSave, 7=ST_ECU_ACLNX_COG_Zustand_Powerdown, 6=ST_ECU_ACLNX_COG_Zustand_Diagnose_Unterspannung_s, 5=ST_ECU_ACLNX_COG_Zustand_Diagnose_Ueberspannung_se, 4=ST_ECU_ACLNX_COG_Zustand_Diagnose, 3=ST_ECU_ACLNX_COG_Zustand_Normalbetrieb_Unterspann, 2=ST_ECU_ACLNX_COG_Zustand_Normalbetrieb_Ueberspannu, 1=ST_ECU_ACLNX_COG_Zustand_Normalbetrieb, 0=ST_ECU_ACLNX_COG_Zustand_Initialisierung
  compu method comQuAclnxCog_Semantic: 5=QU_ACLNX_COG_Signal_ungueltig, 7=QU_ACLNX_COG_Sensor_nicht_vorhanden, 4=QU_ACLNX_COG_Signalwert_ist_ungueltig_Zustand, 2=QU_ACLNX_COG_Abgleichwert_ist_im_Nutzsignal_g, 4=QU_ACLNX_COG_Ersatzwert_ist_im_Nutzsignal_ges, 1=QU_ACLNX_COG_Signalqualitaet_bzw_Ueberwachung, 0=QU_ACLNX_COG_Signalwert_ist_gueltig_Zustand_S, 9=QU_ACLNX_COG_Signalwert_ist_gueltig_und_abgesi, 8=QU_ACLNX_COG_Initialisierung
  compu method comStKlKeyVld_Semantic: 5=ST_KL_KEY_VLD_Signal_ungueltig, 4=ST_KL_KEY_VLD_Fehler, 3=ST_KL_KEY_VLD_Reserve, 6=ST_KL_KEY_VLD_Schluessel_gueltig_fuer_MFS, 5=ST_KL_KEY_VLD_Schluessel_im_10_s_Nachlauf, 4=ST_KL_KEY_VLD_Schluessel_gueltig_im_IR_erkannt, 3=ST_KL_KEY_VLD_Schluessel_gueltig_im_AR_erkannt, 2=ST_KL_KEY_VLD_Schluesselsuche_aktiv, 1=ST_KL_KEY_VLD_Schluessel_ungueltig, 0=ST_KL_KEY_VLD_Init_Wert
  compu method comStDrvVeh_Semantic: 255=ST_DRV_VEH_Signal_ungueltig, 131=ST_DRV_VEH_Initialisierung
  compu method comStPoCabrfRetrf_Semantic: 5=ST_PO_CABRF_RETRF_Signal_ungueltig, 7=ST_PO_CABRF_RETRF_Notverriegelung_durchgefuehrt, 6=ST_PO_CABRF_RETRF_Komplett_geoeffnet, 5=ST_PO_CABRF_RETRF_Komplett_geschlossen, 3=ST_PO_CABRF_RETRF_Unbekannte_Position, 2=ST_PO_CABRF_RETRF_Komplett_geoeffnet_und_verriegelt, 1=ST_PO_CABRF_RETRF_Zwischenstellung, 0=ST_PO_CABRF_RETRF_Komplett_geschlossen_und_verrieg
  compu method comStOpCabrf_Semantic: 5=ST_OP_CABRF_Signal_ungueltig, 3=ST_OP_CABRF_Beladeposition_anfahren, 2=ST_OP_CABRF_schliessen, 1=ST_OP_CABRF_oeffnen, 0=ST_OP_CABRF_keine_Bedienung
  compu method comOpKeyButUlok_Semantic: 0=KEY_BUT_UNLOCK_BUTTON_NOT_PRESSED, 1=KEY_BUT_UNLOCK_BUTTON_PRESSED, 3=KEY_BUT_UNLOCK_NOT_VALID
  compu method comNoKeyPrslImme_Semantic: 15=NO_KEY_PRSL_IMME_INVALID_SIGNAL, 14=NO_KEY_PRSL_IMME_DEFAULT_VALUE, 10=NO_KEY_PRSL_IMME_UNPERSONALISED_VALUE, 3=NO_KEY_PRSL_IMME_KEY_NO_3, 2=NO_KEY_PRSL_IMME_KEY_NO_2, 1=NO_KEY_PRSL_IMME_KEY_NO_1, 0=NO_KEY_PRSL_IMME_KEY_NO_0
  compu method comStChoswExmiDdpdLin_Semantic: 0=ST_CHOSW_EXMI_DDPD_LIN_nicht_codiert, 1=ST_CHOSW_EXMI_DDPD_LIN_Schalterposition_Links, 2=ST_CHOSW_EXMI_DDPD_LIN_Schalterposition_Rechts, 3=ST_CHOSW_EXMI_DDPD_LIN_Signal_ungueltig
  compu method comStPubuExmiFmirLin_Semantic: 0=ST_PUBU_EXMI_FMIR_LIN_nicht_codiert, 1=ST_PUBU_EXMI_FMIR_LIN_Taster_betaetigt, 2=ST_PUBU_EXMI_FMIR_LIN_Taster_nicht_betaetigt, 3=ST_PUBU_EXMI_FMIR_LIN_Signal_ungueltig
  compu method comStPubuExmiDdpdHoadLin_Semantic: 0=ST_PUBU_EXMI_DDPD_HOAD_LIN_keine_Betaetigung, 1=ST_PUBU_EXMI_DDPD_HOAD_LIN_Betaetigung_nach_links, 2=ST_PUBU_EXMI_DDPD_HOAD_LIN_Betaetigung_nach_rechts, 3=ST_PUBU_EXMI_DDPD_HOAD_LIN_Signal_ungueltig
  compu method comStPubuExmiDdpdVeadLin_Semantic: 0=ST_PUBU_EXMI_DDPD_VEAD_LIN_keine_Betaetigung, 1=ST_PUBU_EXMI_DDPD_VEAD_LIN_Betaetigung_nach_oben, 2=ST_PUBU_EXMI_DDPD_VEAD_LIN_Betaetigung_nach_unten, 3=ST_PUBU_EXMI_DDPD_VEAD_LIN_Signal_ungueltig
  compu method comStFnbut1DrdLin_Semantic: 0=ST_FNBUT_1_DRD_LIN_Keine_Betaetigung, 1=ST_FNBUT_1_DRD_LIN_Oeffnen_Betaetigt, 2=ST_FNBUT_1_DRD_LIN_Maut_oeffnen, 3=ST_FNBUT_1_DRD_LIN_Schliessen, 4=ST_FNBUT_1_DRD_LIN_Maut_schliessen, 7=ST_FNBUT_1_DRD_LIN_Signal_ungueltig
  compu method comStFnbut2DrdLin_Semantic: 0=ST_FNBUT_2_DRD_LIN_Keine_Betaetigung, 1=ST_FNBUT_2_DRD_LIN_Oeffnen_Betaetigt, 2=ST_FNBUT_2_DRD_LIN_Maut_oeffnen, 3=ST_FNBUT_2_DRD_LIN_Schliessen, 4=ST_FNBUT_2_DRD_LIN_Maut_schliessen, 7=ST_FNBUT_2_DRD_LIN_Signal_ungueltig
  compu method comCtrWrgFlhDrdLin_Semantic: 0=CTR_WRG_FLH_DRD_LIN_Keine_Betaetigung, 1=CTR_WRG_FLH_DRD_LIN_Oeffnen, 2=CTR_WRG_FLH_DRD_LIN_Maut_oeffnen, 3=CTR_WRG_FLH_DRD_LIN_Schliessen, 4=CTR_WRG_FLH_DRD_LIN_Maut_schliessen, 7=CTR_WRG_FLH_DRD_LIN_Signal_ungueltig
  compu method comCtrWrgRlhDrdLin_Semantic: 0=CTR_WRG_RLH_DRD_LIN_Keine_Betaetigung, 1=CTR_WRG_RLH_DRD_LIN_Oeffnen, 2=CTR_WRG_RLH_DRD_LIN_Maut_oeffnen, 3=CTR_WRG_RLH_DRD_LIN_Schliessen, 4=CTR_WRG_RLH_DRD_LIN_Maut_schliessen, 7=CTR_WRG_RLH_DRD_LIN_Signal_ungueltig
  compu method comCtrWrgFrhDrdLin_Semantic: 0=CTR_WRG_FRH_DRD_LIN_Keine_Betaetigung, 1=CTR_WRG_FRH_DRD_LIN_Oeffnen, 2=CTR_WRG_FRH_DRD_LIN_Maut_oeffnen, 3=CTR_WRG_FRH_DRD_LIN_Schliessen, 4=CTR_WRG_FRH_DRD_LIN_Maut_schliessen, 7=CTR_WRG_FRH_DRD_LIN_Signal_ungueltig
  compu method comCtrWrgRrhDrdLin_Semantic: 0=CTR_WRG_RRH_DRD_LIN_Keine_Betaetigung, 1=CTR_WRG_RRH_DRD_LIN_Oeffnen, 2=CTR_WRG_RRH_DRD_LIN_Maut_oeffnen, 3=CTR_WRG_RRH_DRD_LIN_Schliessen, 4=CTR_WRG_RRH_DRD_LIN_Maut_schliessen, 7=CTR_WRG_RRH_DRD_LIN_Signal_ungueltig
  compu method comNodErrSwclDrLin_Semantic: 0=NOD_ERR_SWCL_DR_LIN_Kein_Fehler, 1=NOD_ERR_SWCL_DR_LIN_Fehler_aktiv, 2=NOD_ERR_SWCL_DR_LIN_Fehler_Statusaenderung, 3=NOD_ERR_SWCL_DR_LIN_Signal_ungueltig
  compu method comCtrWrgAllLin_Semantic: 0=CTR_WRG_ALL_LIN_Keine_Betaetigung, 1=CTR_WRG_ALL_LIN_Oeffnen, 2=CTR_WRG_ALL_LIN_Maut_oeffnen, 3=CTR_WRG_ALL_LIN_Schliessen, 4=CTR_WRG_ALL_LIN_Maut_schliessen, 7=CTR_WRG_ALL_LIN_Signal_ungueltig
  compu method comStWrgEnb_Semantic: 3=ST_WRG_ENB_Signal_ung_ltig, 1=ST_WRG_ENB_FH_sind_freigeschalten, 0=ST_WRG_ENB_FH_sind_nicht_freigeschalten
  compu method comStStsrEnb_Semantic: 3=ST_STSR_ENB_Signal_ung_ltig, 1=ST_STSR_ENB_SHD_CVM_freigeschalten, 0=ST_STSR_ENB_SHD_CVM_nicht_freigeschalten
  compu method comStPanMod_Semantic: 3=ST_PAN_MOD_Signal_ung_ltig, 1=ST_PAN_MOD_Panikmodus_ist_freigeschalten, 0=ST_PAN_MOD_Panikmodus_ist_nicht_freigeschal
  compu method comStChisl_Semantic: 3=ST_CHISL_Signal_ung_ltig, 1=ST_CHISL_Kindersicherung_aktiv, 0=ST_CHISL_Kindersicherung_nicht_aktiv
  compu method comStCffu_Semantic: 15=ST_CFFU_Signal_ung_ltig, 8=ST_CFFU_Cabrio_Komfortanfahren_Beladepos, 11=ST_CFFU_Cabrio_Komfortablegen_Beladeposi, 14=ST_CFFU_Cabrio_Komfortschlie_en_Funkschl, 13=ST_CFFU_Cabrio_Komfort_ffnen_Funkschl_ss, 6=ST_CFFU_Cabrio_Komfortschlie_en_Schlie_z, 5=ST_CFFU_Cabrio_Komfort_ffnen_Schlie_zyli, 2=ST_CFFU_Komfortschlie_en, 1=ST_CFFU_Komfort_ffnen, 0=ST_CFFU_Keine_Aktion
  compu method comCtrWrgPsdCntr_Semantic: 7=CTR_WRG_PSD_CNTR_Signal_ung_ltig, 4=CTR_WRG_PSD_CNTR_Maut_schlie_en, 3=CTR_WRG_PSD_CNTR_Schlie_en, 2=CTR_WRG_PSD_CNTR_Maut_ffnen, 1=CTR_WRG_PSD_CNTR__ffnen, 0=CTR_WRG_PSD_CNTR_Keine_Bet_tigung
  compu method comCtrWrgPsdrCntr_Semantic: 7=CTR_WRG_PSDR_CNTR_Signal_ung_ltig, 4=CTR_WRG_PSDR_CNTR_Maut_schlie_en, 3=CTR_WRG_PSDR_CNTR_Schlie_en, 2=CTR_WRG_PSDR_CNTR_Maut_ffnen, 1=CTR_WRG_PSDR_CNTR__ffnen, 0=CTR_WRG_PSDR_CNTR_Keine_Bet_tigung
  compu method comCtrWrgDvdrCntr_Semantic: 7=CTR_WRG_DVDR_CNTR_Signal_ung_ltig, 4=CTR_WRG_DVDR_CNTR_Maut_schlie_en, 3=CTR_WRG_DVDR_CNTR_Schlie_en, 2=CTR_WRG_DVDR_CNTR_Maut_ffnen, 1=CTR_WRG_DVDR_CNTR__ffnen, 0=CTR_WRG_DVDR_CNTR_Keine_Bet_tigung
  compu method comCtrWrgDrdCntr_Semantic: 7=CTR_WRG_DRD_CNTR_Signal_ung_ltig, 4=CTR_WRG_DRD_CNTR_Maut_schlie_en, 3=CTR_WRG_DRD_CNTR_Schlie_en, 2=CTR_WRG_DRD_CNTR_Maut_ffnen, 1=CTR_WRG_DRD_CNTR__ffnen, 0=CTR_WRG_DRD_CNTR_Keine_Bet_tigung
  compu method comCtrStsrCntr_Semantic: 7=CTR_STSR_CNTR_Signal_ung_ltig, 6=CTR_STSR_CNTR_Senken, 5=CTR_STSR_CNTR_Heben, 4=CTR_STSR_CNTR_Maut_schlie_en, 3=CTR_STSR_CNTR_Schlie_en, 2=CTR_STSR_CNTR_Maut_ffnen, 1=CTR_STSR_CNTR__ffnen, 0=CTR_STSR_CNTR_Keine_Bet_tigung
  compu method comCtrSrblCntr_Semantic: 7=CTR_SRBL_CNTR_Signal_ung_ltig, 4=CTR_SRBL_CNTR_Maut_schlie_en_Schwebehimmel, 3=CTR_SRBL_CNTR_Schlie_en, 2=CTR_SRBL_CNTR_Maut_ffnen, 1=CTR_SRBL_CNTR__ffnen, 0=CTR_SRBL_CNTR_Keine_Bet_tigung
  compu method comCtrChisl_Semantic: 3=CTR_CHISL_Signal_ung_ltig, 1=CTR_CHISL_Aktivieren, 0=CTR_CHISL_Deaktivieren
  compu method comAuthWrgStsr_Semantic: 2147483647=AUTH_WRG_STSR_Signal_ung_ltig
  compu method comOpChislDrd_Semantic: 3=OP_CHISL_DRD_Signal_ung_ltig, 1=OP_CHISL_DRD_Taster_wurde_bet_tigt, 0=OP_CHISL_DRD_Keine_Aktion
  compu method comCtrWrgPsdDrd_Semantic: 7=CTR_WRG_PSD_DRD_Signal_ung_ltig, 4=CTR_WRG_PSD_DRD_Maut_schlie_en, 3=CTR_WRG_PSD_DRD_Schlie_en, 2=CTR_WRG_PSD_DRD_Maut_ffnen, 1=CTR_WRG_PSD_DRD__ffnen, 0=CTR_WRG_PSD_DRD_Keine_Bet_tigung
  compu method comCtrWrgPsdrDrd_Semantic: 7=CTR_WRG_PSDR_DRD_Signal_ung_ltig, 4=CTR_WRG_PSDR_DRD_Maut_schlie_en, 3=CTR_WRG_PSDR_DRD_Schlie_en, 2=CTR_WRG_PSDR_DRD_Maut_ffnen, 1=CTR_WRG_PSDR_DRD__ffnen, 0=CTR_WRG_PSDR_DRD_Keine_Bet_tigung
  compu method comCtrWrgDvdrDrd_Semantic: 7=CTR_WRG_DVDR_DRD_Signal_ung_ltig, 4=CTR_WRG_DVDR_DRD_Maut_schlie_en, 3=CTR_WRG_DVDR_DRD_Schlie_en, 2=CTR_WRG_DVDR_DRD_Maut_ffnen, 1=CTR_WRG_DVDR_DRD__ffnen, 0=CTR_WRG_DVDR_DRD_Keine_Bet_tigung
  compu method comCtrWrgDrdDrd_Semantic: 7=CTR_WRG_DRD_DRD_Signal_ung_ltig, 4=CTR_WRG_DRD_DRD_Maut_schlie_en, 3=CTR_WRG_DRD_DRD_Schlie_en, 2=CTR_WRG_DRD_DRD_Maut_ffnen, 1=CTR_WRG_DRD_DRD__ffnen, 0=CTR_WRG_DRD_DRD_Keine_Bet_tigung
  compu method comCtrWrgPsdPsd_Semantic: 7=CTR_WRG_PSD_PSD_Signal_ung_ltig, 4=CTR_WRG_PSD_PSD_Maut_schlie_en, 3=CTR_WRG_PSD_PSD_Schlie_en, 2=CTR_WRG_PSD_PSD_Maut_ffnen, 1=CTR_WRG_PSD_PSD__ffnen, 0=CTR_WRG_PSD_PSD_Keine_Bet_tigung
  compu method comRqRlsCabrf_Semantic: 3=RQ_RLS_CABRF_Signal_ungueltig, 2=RQ_RLS_CABRF_Dach_schliessen, 1=RQ_RLS_CABRF_Dach_oeffnen, 0=RQ_RLS_CABRF_Keine_Anforderung
  compu method comRqCtrWrgCabrf_Semantic: 5=RQ_CTR_WRG_CABRF_Signal_ungueltig, 3=RQ_CTR_WRG_CABRF_Stopp, 2=RQ_CTR_WRG_CABRF_Anheben_aus_Cabrioposition, 1=RQ_CTR_WRG_CABRF_Absenken_in_Cabrioposition, 0=RQ_CTR_WRG_CABRF_Keine_Aktion
  compu method comStKl_Semantic: 15=ST_KL_Signal_ungueltig, 14=ST_KL_Fehler, 13=ST_KL_KL50_Ein, 12=ST_KL_KL50_Aenderung, 11=ST_KL_KL50_Verzoegerung, 10=ST_KL_KL15_Ein, 9=ST_KL_KL15_Aenderung, 8=ST_KL_KLR_Ein, 7=ST_KL_KLR_Aenderung, 6=ST_KL_KL30B_Ein, 5=ST_KL_KL30B_Aenderung, 4=ST_KL_KL30F_Ein, 3=ST_KL_KL30F_Aenderung, 2=ST_KL_KL30, 1=ST_KL_Reserve, 0=ST_KL_Init
  compu method comAlivCctrStwLin_Semantic: 15=ALIV_CCTR_STW_LIN_Signal_ungueltig
  compu method comAlivCouHud2_Semantic: 5=ALIV_COU_HUD_2_Signal_ungueltig
  compu method comAlivCabrf_Semantic: 5=ALIV_CABRF_Signal_ungueltig
  compu method comAlivCouKl_Semantic: 5=ALIV_COU_KL_Signal_ungueltig
  compu method comAlivAclnxCog_Semantic: 5=ALIV_ACLNX_COG_Signal_ungueltig
  6 x client server interface:
    IComCtrlCtrFhBft
      4 x operation:
        stopCycle
        startCycle100: possible-error=IComCtrlCtrFhBft/E_NOT_OK
        sendOnEvent50: possible-error=IComCtrlCtrFhBft/E_NOT_OK
        sendOnEventWithRepetition160: possible-error=IComCtrlCtrFhBft/E_NOT_OK
      error E_NOT_OK: error-code=1
    IComCtrlCtrFhFat
      4 x operation:
        stopCycle
        startCycle100: possible-error=IComCtrlCtrFhFat/E_NOT_OK
        sendOnEvent50: possible-error=IComCtrlCtrFhFat/E_NOT_OK
        sendOnEventWithRepetition160: possible-error=IComCtrlCtrFhFat/E_NOT_OK
      error E_NOT_OK: error-code=1
    IComCtrlCtrFhShdZentrale
      5 x operation:
        stopCycle
        startCycle2000: possible-error=IComCtrlCtrFhShdZentrale/E_NOT_OK
        startCycle200: possible-error=IComCtrlCtrFhShdZentrale/E_NOT_OK
        sendOnEvent50: possible-error=IComCtrlCtrFhShdZentrale/E_NOT_OK
        sendOnEventWithRepetition160: possible-error=IComCtrlCtrFhShdZentrale/E_NOT_OK
      error E_NOT_OK: error-code=1
    IComCtrlPositionFhBft
      operation sendOnEvent50: possible-error=IComCtrlPositionFhBft/E_NOT_OK
      operation sendOnEvent200: possible-error=IComCtrlPositionFhBft/E_NOT_OK
      operation sendOnEventWithRepetition160: possible-error=IComCtrlPositionFhBft/E_NOT_OK
      error E_NOT_OK: error-code=1
    IComCtrlPositionFhFat
      operation sendOnEvent200: possible-error=IComCtrlPositionFhFat/E_NOT_OK
      operation sendOnEvent50: possible-error=IComCtrlPositionFhFat/E_NOT_OK
      operation sendOnEventWithRepetition160: possible-error=IComCtrlPositionFhFat/E_NOT_OK
      error E_NOT_OK: error-code=1
    IComTx0x6ESvcFem
      operation com0x6ESvcFem
        arg sendMode: type=UInt8, direction=IN
        arg comIdFnCos: type=UInt16, direction=IN
        arg comStFnCos: type=UInt2, direction=IN
